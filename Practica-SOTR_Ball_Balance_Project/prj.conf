## Kconfig
```
mainmenu "MYAPP"

source "Kconfig.zephyr"
config MYAPP_STM32
  default y
  bool
  select USE_STM32_HAL_GPIO
  select USE_STM32_LL_GPIO
  select USE_STM32_HAL_ADC
  select USE_STM32_LL_ADC
  select USE_STM32_HAL_DMA
  select USE_STM32_LL_DMA
  select USE_STM32_HAL_CORTEX
  select USE_STM32_LL_CORTEX
  select USE_STM32_HAL_PWR_EX
  select USE_STM32_LL_PWR_EX
  select USE_STM32_HAL_LTDC
  select USE_STM32_LL_LTDC
```

## prj.conf
```kconfig
CONFIG_USE_STM32_ASSERT=y
CONFIG_ASSERT=y

CONFIG_GPIO=y

# Enable pthreads
CONFIG_PTHREAD_IPC=y

CONFIG_NEWLIB_LIBC=y

CONFIG_PRINTK=y
CONFIG_STDOUT_CONSOLE=y

#Enable FPU
CONFIG_FPU=y
CONFIG_FPU_SHARING=y

# Config stack size
CONFIG_MAIN_STACK_SIZE=1024
```

## include/HAL_ADC.h
```c
/* ADC handler declaration */
ADC_HandleTypeDef AdcHandle;

//ADC FUNCTIONS:
void ADC_Config(void);
void Error_Handler(void);
void SystemClock_Config(void);
void ADC_Select_CH0(void);
```

## include/controller.h
```c
#include <posix/pthread.h>

#define CONTROLLER_DIST_FAR 220
#define CONTROLLER_DIST_NEAR 740

uint16_t controller_get_ball_pos();

void controller_status(uint16_t *dist_objective, uint16_t *dist_current, int *current_angle,
		       int *integral_factor);

pthread_t controller_initialize(int prio, struct timespec period);
```

## include/gui.h
```c
#ifndef _BALANCER_GUI_H_
#define _BALANCER_GUI_H_
#include <posix/pthread.h>
#define TEXT_Y 40
#define TEXT_X 300

/*
 * Create the gui thread.
 * @param prio priority of the thread.
 * @param period period of the thread.
 * @param real_x_left real x coordenate of the left border of the bar. It is
 * the value used by the controller as input poisition value.
 * @param real_y_left real y coordenate of the left border of the bar. It is
 * the value used by the controller as input poisition value.
 */
int gui_initialize(int prio, struct timespec period, int real_x_left, int real_x_right);

// User's ball X position in range real_x_left..real_x_right
uint16_t gui_get_real_ball_x();

#endif // _BALANCER_GUI_H_
```

## include/screen.h
```c
#include <stdint.h>
#undef LED_GREEN
#include "stm32f7xx_hal_ltdc.h"

int screen_initialize();

int screen_get_x_size();

int screen_get_x_touch();

void screen_fill_rectangle(uint16_t x_pos, uint16_t y_pos, uint16_t ancho_x, uint16_t alto_y,
			   uint32_t color);

void screen_delete_rectangle(uint16_t x_pos, uint16_t y_pos, uint16_t ancho_x, uint16_t alto_y);

void screen_fill_circle(uint16_t x_pos, uint16_t y_pos, uint16_t radio, uint32_t color);

void screen_draw_circle(uint16_t x_pos, uint16_t y_pos, uint16_t radio, uint32_t color);

void screen_delete_circle(uint16_t x_pos, uint16_t y_pos, uint16_t radio);

void screen_print_text(uint16_t x_pos, uint16_t y_pos, char *text, uint32_t color);
```

## include/stepper_motor.h
```c
#include <posix/pthread.h>

// Initialice the internal thread to manage a stepper motor.
// Return the internal thread id.
pthread_t stepper_motor_initialize(int prio);

// Set the desired speed.
void stepper_motor_setspeed(double grads_per_second);

// Move to the desired step at the preset speed.
void stepper_motor_move_to_step(int step_objective);

// Rotate one step clockwise.
// Continuos movement is stopped.
void stepper_motor_step_clockwise();

// Rotate one step anticlockwise.
// Continuos movement is stopped.
void stepper_motor_step_anticlockwise();

int stepper_motor_get_current_step();

int stepper_motor_get_current_step_objective();

void stepper_motor_status(int *step_current, int *step_objective);
```

## src/controller.c
```c
//Standard C + POSIX API
#include <stdio.h>
#include <posix/unistd.h>
#include <posix/pthread.h>
//#include <sched.h>
#include <time.h>
#include <errno.h>

// HAL API
#include <stm32f7xx_hal.h>
#include <stm32f7xx_hal_adc.h>

//Modules
#include <misc/error_checks.h>
#include <misc/timespec_operations.h>
#include "gui.h"
#include "stepper_motor.h"
#include "controller.h"

#define DIST_READ_MARGIN 0
#define DIST_MIN 500

#define KP -0.08
#define KI 0 // -0.00001

/* ADC handler declaration */
static ADC_HandleTypeDef AdcHandle;

//ADC FUNCTIONS:
static void ADC_Config(void);
static void Error_Handler(void);
static void SystemClock_Config(void);
static void ADC_Select_CH1(void);

static void SystemClock_Config(void)
{
	__HAL_RCC_ADC1_CLK_ENABLE(); // Habilita el reloj ADC1
}

static void ADC_Select_CH1(void)
{
	ADC_ChannelConfTypeDef sConfig = { 0 };
	/* Configure for the selected ADC regular channel its corresponding rank in the sequencer and its sample time.
  */
	sConfig.Channel = ADC_CHANNEL_4;
	sConfig.Rank = 1;
	sConfig.SamplingTime = ADC_SAMPLETIME_56CYCLES;
	sConfig.Offset = 0;
	if (HAL_ADC_ConfigChannel(&AdcHandle, &sConfig) != HAL_OK) {
		Error_Handler();
	}
}

/**
  * @brief  Configure the ADC.
  * @param  None
  * @retval None
  */
static void ADC_Config(void)
{
	/* Configure the ADC peripheral */
	AdcHandle.Instance = ADC1;
	AdcHandle.Init.ClockPrescaler = ADC_CLOCKPRESCALER_PCLK_DIV4;
	AdcHandle.Init.Resolution = ADC_RESOLUTION_12B;
	AdcHandle.Init.ScanConvMode =
		ENABLE; /* Sequencer disabled (ADC conversion on only 1 channel: channel set on rank 1) */
	AdcHandle.Init.ContinuousConvMode =
		ENABLE; /* Continuous mode enabled to have continuous conversion */
	AdcHandle.Init.DiscontinuousConvMode =
		DISABLE; /* Parameter discarded because sequencer is disabled */
	AdcHandle.Init.NbrOfDiscConversion = 0;
	AdcHandle.Init.ExternalTrigConvEdge =
		ADC_EXTERNALTRIGCONVEDGE_NONE; /* Conversion start not trigged by an external event */
	AdcHandle.Init.ExternalTrigConv = ADC_SOFTWARE_START;
	AdcHandle.Init.DataAlign = ADC_DATAALIGN_RIGHT;
	AdcHandle.Init.NbrOfConversion = 1;
	AdcHandle.Init.DMAContinuousRequests = DISABLE;
	AdcHandle.Init.EOCSelection = DISABLE;

	if (HAL_ADC_Init(&AdcHandle) != HAL_OK) {
		/* ADC initialization Error */
		Error_Handler();
	}
}

/**
  * @brief  This function is executed in case of error occurrence.
  * @param  None
  * @retval None
  */
static void Error_Handler(void)
{
	while (1) {
		//Print error message
		printf("Error...");

		// Sleep 20 ms
		HAL_Delay(20);
	}
}

static uint16_t dist_input_gui;
static uint16_t distance = (CONTROLLER_DIST_NEAR - CONTROLLER_DIST_FAR) / 2;
static int angle;
static int integral = 0;

static int distance_mean()
{
#define NUM_MEASUREMENTS 3
	uint32_t sum = 0;
	uint32_t measure = 0;
	for (int i = 0; i < NUM_MEASUREMENTS; i++) {
		do {
			// Select ADC_CH1
			ADC_Select_CH1();
			HAL_ADC_Start(&AdcHandle);
			HAL_ADC_PollForConversion(&AdcHandle, 1000);
			measure = HAL_ADC_GetValue(&AdcHandle);
			HAL_ADC_Stop(&AdcHandle);
		} while (measure < CONTROLLER_DIST_FAR - DIST_READ_MARGIN ||
			 measure > CONTROLLER_DIST_NEAR + DIST_READ_MARGIN);
		sum += measure;
	}
	uint32_t dist = sum / NUM_MEASUREMENTS;
	//printf("x:%d\n", dist);
	return dist;
	/*
  printf("x:%d\n", dist);
  //  x  -> y
  // 45  -> 97 mm
  // 390 -> 65 mm

  // 290  -> 95 mm
  // 650  -> 35 mm
  //const double a = (45.0 - 390.0) / (97.0 - 65.0);
  const double a = (290.0 - 650.0) / (95.0 - 35.0);
  const double b = 3936;
     return (int) (a * dist + b);
  */
}

/*
double controller_get_ball_pos_rel() {
  return 1.0 - (((double) distance - DIST_FAR) / (DIST_NEAR - DIST_FAR));
   }
 */

uint16_t controller_get_ball_pos()
{
	return distance;
}

void controller_status(uint16_t *dist_objective, uint16_t *dist_current, int *current_angle,
		       int *integral_factor)
{
	*dist_objective = dist_input_gui;
	*dist_current = distance;
	*current_angle = angle;
	*integral_factor = integral;
}

struct timespec thread_period;

static void *controller_thread_body(void *arg)
{
	//int dist_prev = analogRead(ANALOG_PIN);
	integral = 0;

	//Configure sharp sensor with HAL API

	SystemClock_Config();

	/* Configure the ADC peripheral*/
	ADC_Config();

	// Hal API
	GPIO_InitTypeDef GPIO_InitStruct;

	// Pin A1 is in PA4, so we need to set it up!
	GPIO_InitStruct.Pin = GPIO_PIN_4;
	GPIO_InitStruct.Mode = GPIO_MODE_ANALOG;
	GPIO_InitStruct.Speed = GPIO_SPEED_HIGH;
	HAL_GPIO_Init(GPIOA, &GPIO_InitStruct);

	while (true) {
		dist_input_gui = gui_get_real_ball_x();
		//uint16_t dist_input_gui = (CONTROLLER_DIST_FAR + CONTROLLER_DIST_NEAR) / 2 - 100;
		distance = distance_mean();

		integral += dist_input_gui - distance;
		angle = (dist_input_gui - distance) * KP + integral * KI;
		//printf("d:%d o:%d angle:%d \n", dist_current, dist_input_gui, angle);
		stepper_motor_move_to_step(angle);

		long period_ms = timespec2msec(&thread_period);
		k_msleep(period_ms);
	}
}

pthread_t controller_initialize(int prio, struct timespec period)
{
	pthread_attr_t attr;
	pthread_t th;
	struct sched_param sch_param;

	thread_period = period;

	CHK(pthread_attr_init(&attr));
	//CHK(pthread_attr_setinheritsched(&attr, PTHREAD_EXPLICIT_SCHED)); //FIXME:
	CHK(pthread_attr_setdetachstate(&attr, PTHREAD_CREATE_JOINABLE));
	CHK(pthread_attr_setschedpolicy(&attr, SCHED_FIFO));
	sch_param.sched_priority = prio;
	CHK(pthread_attr_setschedparam(&attr, &sch_param));
	CHK(pthread_create(&th, &attr, controller_thread_body, NULL));

	return th;
}
```

## src/demo_sharp.c
```c
#include <stdio.h>
#include <posix/unistd.h>

// HAL API
#include <stm32f7xx_hal.h>
#include <stm32f7xx_hal_adc.h>
#include "HAL_ADC.h"

//  x  -> y
// 45  -> 97 mm
// 390 -> 65 mm

// 290  -> 95 mm
// 650  -> 35 mm
// const double a = (45.0 - 390.0) / (97.0 - 65.0);
//const double a = (290.0 - 650.0) / (95.0 - 35.0);
//const double b = 3936;

uint32_t sharp_sensor_dist_mm()
{
	uint32_t measure = 0;
	// Select ADC_CH0
	ADC_Select_CH0();
	HAL_ADC_Start(&AdcHandle);
	HAL_ADC_PollForConversion(&AdcHandle, 1000);
	measure = HAL_ADC_GetValue(&AdcHandle);
	HAL_ADC_Stop(&AdcHandle);
	//uint32_t dist_mm = (uint32_t) (a * measure + b);
	uint32_t dist_mm = ((2914.0 / (measure + 5.0)) - 1.0) * 10;
	printf("adc:%d mm:%d\n", measure, dist_mm);
	return dist_mm;
}

int main(int argc, char **argv)
{
	printf("Demo Sharp\n");
	//uint32_t dist = 0;

	//Configure sharp sensor with HAL API
	SystemClock_Config();

	/* Configure the ADC peripheral*/
	ADC_Config();

	// Hal API
	GPIO_InitTypeDef GPIO_InitStruct;

	// Pin A0 is in PA6, so we need to set it up!
	GPIO_InitStruct.Pin = GPIO_PIN_6;
	GPIO_InitStruct.Mode = GPIO_MODE_ANALOG;
	GPIO_InitStruct.Speed = GPIO_SPEED_HIGH;
	HAL_GPIO_Init(GPIOA, &GPIO_InitStruct);

	while (1) {
		sharp_sensor_dist_mm();
		sleep(2);
	}

	return 0;
}
```

## src/demo_stepper.c
```c
#include <stdio.h>
#include <posix/unistd.h>
#include "stepper_motor.h"

const int stepper_prio = 9;
#define STEPPER_PIN_1 5
#define STEPPER_PIN_2 6
#define STEPPER_PIN_3 7
#define STEPPER_PIN_4 8

#define STEPS 120

int main(int argc, char **argv)
{
	printf("Demo stepper in pins %d %d %d %d\n", STEPPER_PIN_1, STEPPER_PIN_2, STEPPER_PIN_3,
	       STEPPER_PIN_4);

	stepper_motor_initialize(STEPPER_PIN_1, STEPPER_PIN_2, STEPPER_PIN_3, STEPPER_PIN_4,
				 stepper_prio);
	stepper_motor_setspeed(6);
	printf("s:%d o:%d\n", stepper_motor_get_current_step(),
	       stepper_motor_get_current_step_objective());

	for (int i = 0; i < 3; i++) {
		stepper_motor_move_to_step(STEPS);
		printf("s:%d o:%d\n", stepper_motor_get_current_step(),
		       stepper_motor_get_current_step_objective());

		sleep(4);
		printf("End s:%d o:%d\n", stepper_motor_get_current_step(),
		       stepper_motor_get_current_step_objective());

		stepper_motor_move_to_step(-STEPS);
		printf("s:%d o:%d\n", stepper_motor_get_current_step(),
		       stepper_motor_get_current_step_objective());

		sleep(4);
		printf("End s:%d o:%d\n", stepper_motor_get_current_step(),
		       stepper_motor_get_current_step_objective());
	}

	stepper_motor_move_to_step(0);
	printf("s:%d o:%d\n", stepper_motor_get_current_step(),
	       stepper_motor_get_current_step_objective());

	sleep(4);
	printf("End s:%d o:%d\n", stepper_motor_get_current_step(),
	       stepper_motor_get_current_step_objective());

	return 0;
}
```

## src/gui.c
```c
//Standart C + POSIX API
#include <posix/pthread.h>
#include <time.h>
#include <stdio.h>
#include <stdint.h>

//Modules
#include "misc/timespec_operations.h"
#include "misc/error_checks.h"
#include "controller.h"
#include "screen.h"
#include "stepper_motor.h"
#include "gui.h"

#define BAR_LENGTH 600
#define BAR_HIGH 40
#define BALL_COLOR LCD_COLOR_BLACK
#define BALL_REAL_COLOR LCD_COLOR_RED
#define BAR_COLOR LCD_COLOR_BLUE
#define BALL_Y 250
#define BAR_Y 300
#define BAR_X_MIN 100
#define BAR_X_MAX (BAR_X_MIN + BAR_LENGTH)
#define BALL_RADIO (BAR_Y - BALL_Y)

static uint16_t dist_left_x;
static uint16_t dist_right_x;

static volatile uint16_t ball_touch_x;

/*static int dist_to_pixel(int dist) {
  int dist_rel = ((double) dist - dist_left_x) /
  ((double) dist_right_x - dist_left_x);
  int x_pixel =  dist_rel * BAR_LENGTH + BAR_X;
  printf("dist_rel:%d x_pixel:%d\n", dist_rel, x_pixel);
  return x_pixel;
}*/

static long map(long x, long in_min, long in_max, long out_min, long out_max)
{
	return (x - in_min) * (out_max - out_min) / (float)(in_max - in_min) + out_min;
}

uint16_t gui_get_real_ball_x()
{
	return map(ball_touch_x, BAR_X_MIN, BAR_X_MAX, dist_left_x, dist_right_x);
}

static struct timespec thread_period;

void *gui_thread_body(void *args)
{
	uint16_t real_ball_x;
	ball_touch_x = screen_get_x_size() / 2;

	while (1) {
		// clear balls in the former position
		screen_delete_circle(ball_touch_x, BALL_Y, BALL_RADIO);
		screen_delete_circle(real_ball_x, BALL_Y, BALL_RADIO);

		// read current ball position
		//real_ball_x = dist_to_pixel(controller_get_ball_pos());
		real_ball_x = map(controller_get_ball_pos(), dist_left_x, dist_right_x, BAR_X_MIN,
				  BAR_X_MAX);

		// read touch
		int touch_x = screen_get_x_touch();
		if (touch_x != -1) {
			if (touch_x > BAR_X_MAX) {
				touch_x = BAR_X_MAX;
			}
			if (touch_x < BAR_X_MIN) {
				touch_x = BAR_X_MIN;
			}

			ball_touch_x = touch_x;
		}
		//printf("GUI: R:%d  Touch:%d\n", real_ball_x, ball_touch_x);

		// print bar and balls
		screen_fill_rectangle(BAR_X_MIN, BAR_Y, BAR_LENGTH, BAR_HIGH, BAR_COLOR);
		screen_fill_circle(ball_touch_x, BALL_Y, BALL_RADIO, BALL_COLOR);
		screen_draw_circle(real_ball_x, BALL_Y, BALL_RADIO, BALL_REAL_COLOR);

		// print status
		char str[25];
		snprintf(str, 25, "Pixel ball:%3d touch:%3d", real_ball_x, ball_touch_x);
		screen_print_text(TEXT_X, TEXT_Y, str, LCD_COLOR_BLACK);
		snprintf(str, 25, "Real  ball:%3d touch:%3d", controller_get_ball_pos(),
			 gui_get_real_ball_x());
		screen_print_text(TEXT_X, TEXT_Y + 30, str, LCD_COLOR_BLACK);

		// print stepper status
		int step_current;
		int step_objective;
		stepper_motor_status(&step_current, &step_objective);
		snprintf(str, 25, "Stepper %3d -> %3d", step_current, step_objective);
		screen_print_text(TEXT_X, TEXT_Y + 60, str, LCD_COLOR_BLACK);

		// print controller status
		uint16_t dist_objective;
		uint16_t dist_current;
		int current_angle;
		int integral_factor;
		controller_status(&dist_objective, &dist_current, &current_angle, &integral_factor);
		snprintf(str, 25, "Ctr %3d->%3d->%3d i:%3d", dist_objective, dist_current,
			 current_angle, integral_factor);
		screen_print_text(TEXT_X, TEXT_Y + 90, str, LCD_COLOR_BLACK);

		// Wait for the next activation
		long period_ms = timespec2msec(&thread_period);
		k_msleep(period_ms);
	}
}

int gui_initialize(int prio, struct timespec period, int real_x_left, int real_x_right)
{
	screen_initialize();

	thread_period = period;
	dist_left_x = real_x_left;
	dist_right_x = real_x_right;

	// create thread
	pthread_attr_t attr;
	pthread_t th;
	struct sched_param sch_param;

	// Crea el objeto de atributos
	CHK(pthread_attr_init(&attr));
	//CHK(pthread_attr_setinheritsched(&attr, PTHREAD_EXPLICIT_SCHED)); //FIXME:
	CHK(pthread_attr_setdetachstate(&attr, PTHREAD_CREATE_JOINABLE));
	CHK(pthread_attr_setschedpolicy(&attr, SCHED_FIFO));
	sch_param.sched_priority = prio;
	CHK(pthread_attr_setschedparam(&attr, &sch_param));
	CHK(pthread_create(&th, &attr, gui_thread_body, NULL));

	return 0;
}
```

## src/lcd_driver.c
```c
// /*----------------------------------------------------------------------------
//  *-------------------------      M a R T E   O S      ------------------------
//  *----------------------------------------------------------------------------
//  *                                                             {MARTE_VERSION}
//  *
//  *                           'l c d _ d r i v e r _ c'
//  *
//  *                                      C
//  *
//  *  File 'lcd_driver_c.c'                                  by MAR.
//  *
//  *  Driver for the LCD of the stm32f769disco board.
//  *
//  *
//  *  {MARTE_COPYRIGHT}
//  *
//  *---------------------------------------------------------------------------*/

// #include <stdint.h>
// #include <string.h>
// #include "stm32f7xx_hal.h"
// //#include "stm32f769i_discovery.h"
// //#include "stm32f769i_discovery_lcd.h"

// // Defined in GNAT_IO_Driver_Functions
// int gnat_io_driver_functions__create();
// ssize_t gnat_io_driver_functions__write(int file_descriptor, uint8_t *buffer, size_t bytes);

// static int initialized = 0;

// // cursor position
// static uint16_t cursorLine = 0;
// static uint16_t cursorCol = 0;

// // screen parameters
// static uint16_t lineHeight = 10;
// static uint16_t colWidth = 10;
// static uint16_t LINES_MX = 10;
// static uint16_t COLS_MX = 10;

// //static uint8_t lineBuffer[100];
// #define TOP_OFFSET 0

// #define CURSOR_Y (cursorLine * lineHeight + TOP_OFFSET)
// #define CURSOR_X (cursorCol * colWidth)

// ssize_t lcd_write(int file_descriptor, uint8_t *buffer, size_t bytes);

// /************/
// /*  Create  */
// /************/

// int lcd_create()
// {
// 	// LCD can not be used during MaRTE initialization since, during its
// 	// initialization, it performs a delay which requires interrupts to be
// 	// enabled in order to count ticks (otherwise initialization gets blocked in
// 	// the delay).
// 	// We use a led to show lcd_write has been called.

// 	BSP_LED_Init(LED1);
// 	BSP_LED_Init(LED2);
// 	BSP_LED_Toggle(LED1);
// 	return 0;
// }

// /**************************************/
// /*  lcd_end_of_kernel_initialization  */
// /**************************************/

// int lcd_end_of_kernel_initialization()
// {
// 	uint32_t lcd_status = LCD_OK;

// 	// Initialize the LCD
// 	lcd_status = BSP_LCD_Init();
// 	while (lcd_status != LCD_OK)
// 		;

// 	BSP_LCD_LayerDefaultInit(0, LCD_FB_START_ADDRESS);

// 	// Clear the LCD
// 	BSP_LCD_Clear(LCD_COLOR_WHITE);

// 	// set font
// 	BSP_LCD_SetFont(&Font20);

// 	// console parameters
// 	lineHeight = ((sFONT *)BSP_LCD_GetFont())->Height;
// 	colWidth = ((sFONT *)BSP_LCD_GetFont())->Width;
// 	LINES_MX = (BSP_LCD_GetYSize() - TOP_OFFSET) / lineHeight;
// 	COLS_MX = BSP_LCD_GetXSize() / colWidth;

// 	initialized = 1;

// 	// write marte header
// 	BSP_LCD_SetTextColor(LCD_COLOR_BLUE);
// 	lcd_write(1, (uint8_t *)"MaRTE OS executing user's code...\n", 34);

// 	BSP_LCD_SetTextColor(LCD_COLOR_BLACK);

// 	return 0;
// }

// static void nextCol();

// static void nextLine()
// {
// 	cursorLine = (cursorLine + 1) % LINES_MX;
// 	cursorCol = 0;
// 	// clear next line
// 	for (int i = 0; i < COLS_MX; i++) {
// 		BSP_LCD_DisplayChar(CURSOR_X, CURSOR_Y, ' ');
// 		cursorCol++;
// 	}
// 	cursorCol = 0;
// }

// static void nextCol()
// {
// 	cursorCol = (cursorCol + 1) % COLS_MX;
// 	if (cursorCol == 0) {
// 		nextLine();
// 	}
// }

// /***********/
// /*  Write  */
// /***********/

// ssize_t lcd_write(int file_descriptor, uint8_t *buffer, size_t bytes)
// {
// 	if (!initialized) {
// 		BSP_LED_Toggle(LED2);
// 		return bytes;
// 	}

// 	for (int i = 0; i < bytes; i++) {
// 		if (buffer[i] == '\n') {
// 			nextLine();
// 		} else {
// 			BSP_LCD_DisplayChar(CURSOR_X, CURSOR_Y, buffer[i]);
// 			nextCol();
// 		}
// 	}

// 	/*   if (buffer[bytes-1] != '\n') { */
// 	/*     BSP_LCD_DisplayChar(CURSOR_X, CURSOR_Y, '\n'); */
// 	/*   } */

// 	/*   memcpy(lineBuffer, buffer, bytes); */
// 	/*   lineBuffer[bytes] = 0; */
// 	/*    */
// 	/*   BSP_LCD_DisplayStringAt(CURSOR_X, CURSOR_Y, lineBuffer, LEFT_MODE); */
// 	/*    */
// 	/*   cursorLine++; */
// 	/*   cursorCol = 0; */

// 	return bytes;
// }
```

## src/pract10_ball_balance.c
```c
//Standard C + POSIX API
#include <stdio.h>
#include <posix/unistd.h>
#include <stdlib.h>
#include <posix/pthread.h>

//Modules
#include <misc/error_checks.h>
#include "gui.h"
#include "stepper_motor.h"
#include "controller.h"
#include "screen.h"

const int stepper_prio = 9;
const int controller_prio = 7;
const struct timespec controller_period = { 0, 5000000 };
const int gui_prio = 4;
const struct timespec gui_period = { 0, 300000000 };

// procedimiento principal
int main(void)
{
	pthread_t th_controller;
	printf("Ball balance\n");
	k_msleep(1000);

	// inicializar pantalla
	screen_initialize();

	//inicializar gui
	gui_initialize(gui_prio, gui_period, CONTROLLER_DIST_NEAR, CONTROLLER_DIST_FAR);

	// inicializar stepper motor
	stepper_motor_initialize(stepper_prio);

	// inicializar controlador
	th_controller = controller_initialize(controller_prio, controller_period);
	CHK(pthread_join(th_controller, NULL));

	while (0) {
		for (int i = 0; i < 600; i++) {
			printf("Step Clockwise\n");
			stepper_motor_step_clockwise();
			usleep(20);
		}

		for (int i = 0; i < 600; i++) {
			printf("Step Anticlockwise\n");
			stepper_motor_step_anticlockwise();
			usleep(20);
		}
	}

	const int grads_per_second = 4;
	while (0) {
		printf("Rotate at %d grad/s\n", grads_per_second);
		stepper_motor_setspeed(grads_per_second);
		sleep(5);

		printf("Rotate at %d grad/s\n", grads_per_second);
		stepper_motor_setspeed(-grads_per_second);
		sleep(5);

		printf("Dist:%d\n", analogRead(0));
	}

	while (0) {
		printf("Dist:%d\n", analogRead(0));
		sleep(1);
	}

	return 0;
}
```

## src/screen.c
```c
#include <stdio.h>
#include "stm32f7xx_hal.h"
#include <stm32f7xx.h>
#include "stm32f7xx_hal_ltdc.h"
#include "screen.h"

#define BACKGROUND_COLOR LCD_COLOR_WHITE

int screen_initialize()
{
	BSP_LCD_SetFont(&Font24);

	if (BSP_TS_Init(BSP_LCD_GetXSize(), BSP_LCD_GetYSize())) {
		printf("Error: BSP_TS_Init\n");
		return -1;
	}
	return 0;
}

int screen_get_x_size()
{
	return BSP_LCD_GetXSize();
}

int screen_get_y_size()
{
	return BSP_LCD_GetYSize();
}

int screen_get_x_touch()
{
	TS_StateTypeDef touch;
	BSP_TS_GetState(&touch);

	if (touch.touchDetected) {
		return touch.touchX[0];
	}
	return -1;
}

void screen_fill_rectangle(uint16_t x_pos, uint16_t y_pos, uint16_t ancho_x, uint16_t alto_y,
			   uint32_t color)
{
	BSP_LCD_SetTextColor(color);
	BSP_LCD_FillRect(x_pos, y_pos, ancho_x, alto_y);
}

void screen_delete_rectangle(uint16_t x_pos, uint16_t y_pos, uint16_t ancho_x, uint16_t alto_y)
{
	BSP_LCD_SetTextColor(BACKGROUND_COLOR);
	BSP_LCD_FillRect(x_pos, y_pos, ancho_x, alto_y);
}

void screen_fill_circle(uint16_t x_pos, uint16_t y_pos, uint16_t radio, uint32_t color)
{
	BSP_LCD_SetTextColor(color);
	BSP_LCD_FillCircle(x_pos, y_pos, radio);
}

void screen_draw_circle(uint16_t x_pos, uint16_t y_pos, uint16_t radio, uint32_t color)
{
	BSP_LCD_SetTextColor(color);
	BSP_LCD_DrawCircle(x_pos, y_pos, radio);
}

void screen_delete_circle(uint16_t x_pos, uint16_t y_pos, uint16_t radio)
{
	BSP_LCD_SetTextColor(BACKGROUND_COLOR);
	BSP_LCD_FillCircle(x_pos, y_pos, radio);
}

void screen_print_text(uint16_t x_pos, uint16_t y_pos, char *text, uint32_t color)
{
	BSP_LCD_SetTextColor(color);
	BSP_LCD_DisplayStringAt(x_pos, y_pos, (unsigned char *)text, LEFT_MODE);
}
```
