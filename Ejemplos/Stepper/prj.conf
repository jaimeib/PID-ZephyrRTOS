## prj.conf
```kconfig
CONFIG_ASSERT=y
CONFIG_GPIO=y

CONFIG_NEWLIB_LIBC=y

# Enable pthreads
CONFIG_PTHREAD_IPC=y

CONFIG_PRINTK=y
CONFIG_STDOUT_CONSOLE=y

#Enable FPU
CONFIG_FPU=y
CONFIG_FPU_SHARING=y

# Config stack size
CONFIG_MAIN_STACK_SIZE=1024
```

## include/stepper_motor.h
```c
#include <posix/pthread.h>

#define GPIO_IN1_PORT GPIOJ
#define GPIO_IN1_PIN GPIO_PIN_4
#define GPIO_IN2_PORT GPIOJ
#define GPIO_IN2_PIN GPIO_PIN_3
#define GPIO_IN3_PORT GPIOF
#define GPIO_IN3_PIN GPIO_PIN_7
#define GPIO_IN4_PORT GPIOC
#define GPIO_IN4_PIN GPIO_PIN_8

// Initialice the internal thread to manage a stepper motor.
// Return the internal thread id.
pthread_t stepper_motor_initialize(int prio);

// Set the desired speed.
void stepper_motor_setspeed(double grads_per_second);

// Move to the desired step at the preset speed.
void stepper_motor_move_to_step(int step_objective);

// Rotate one step clockwise.
// Continuos movement is stopped.
void stepper_motor_step_clockwise();

// Rotate one step anticlockwise.
// Continuos movement is stopped.
void stepper_motor_step_anticlockwise();

int stepper_motor_get_current_step();

int stepper_motor_get_current_step_objective();

void stepper_motor_status(int *step_current, int *step_objective);
```

## src/demo_stepper.c
```c
#include <stdio.h>
#include <posix/unistd.h>
#include "stepper_motor.h"

const int stepper_prio = 9;
#define STEPPER_PIN_1 5
#define STEPPER_PIN_2 6
#define STEPPER_PIN_3 7
#define STEPPER_PIN_4 8

#define STEPS 120

int main(int argc, char **argv)
{
	printf("Demo stepper in pins %d %d %d %d\n", STEPPER_PIN_1, STEPPER_PIN_2, STEPPER_PIN_3,
	       STEPPER_PIN_4);

	stepper_motor_initialize(stepper_prio);
	stepper_motor_setspeed(6);
	printf("s:%d o:%d\n", stepper_motor_get_current_step(),
	       stepper_motor_get_current_step_objective());

	for (int i = 0; i < 3; i++) {
		stepper_motor_move_to_step(STEPS);
		printf("s:%d o:%d\n", stepper_motor_get_current_step(),
		       stepper_motor_get_current_step_objective());

		k_msleep(4000);
		printf("End s:%d o:%d\n", stepper_motor_get_current_step(),
		       stepper_motor_get_current_step_objective());

		stepper_motor_move_to_step(-STEPS);
		printf("s:%d o:%d\n", stepper_motor_get_current_step(),
		       stepper_motor_get_current_step_objective());

		k_msleep(4000);
		printf("End s:%d o:%d\n", stepper_motor_get_current_step(),
		       stepper_motor_get_current_step_objective());
	}

	stepper_motor_move_to_step(0);
	printf("s:%d o:%d\n", stepper_motor_get_current_step(),
	       stepper_motor_get_current_step_objective());

	k_msleep(4000);
	printf("End s:%d o:%d\n", stepper_motor_get_current_step(),
	       stepper_motor_get_current_step_objective());

	return 0;
}
```

## src/stepper_motor.c
```c
//Standard C + POSIX API
#include <stdio.h>
#include <posix/unistd.h>
#include <posix/pthread.h>
//#include <sched.h>
#include <time.h>
#include <math.h>

// HAL API
#include <stm32f7xx_hal.h>

//Modules
#include <misc/error_checks.h>
#include <misc/timespec_operations.h>
#include "stepper_motor.h"

//Threads stacks declaration
#define STACKSIZE 1024
K_THREAD_STACK_ARRAY_DEFINE(stacks, 1, STACKSIZE);

static int step_counter = 0; // contador para los pasos
static int step_counter_objective = 0;

#define STEPS_PER_GRAD 11.322
#define MX_GRADS_PER_S 20

//secuencia media fase
#define NUM_STEPS 8
static const char steps_lookup[NUM_STEPS] = { 0b1000, 0b1100, 0b0100, 0b0110,
					      0b0010, 0b0011, 0b0001, 0b1001 };

#define PERIOD_INACTIVE_NS 10000000 // 10 ms
static struct timespec thread_period = { 0, PERIOD_INACTIVE_NS };
static double rotating_speed_grads_per_second = 0.0;

static int step_index()
{
	int mod = step_counter % NUM_STEPS;
	if (mod < 0) {
		mod = mod + NUM_STEPS;
	}
	return mod;
}

static int bitRead(int value, int bit)
{
	return (value >> bit) & 0b0001;
}

static void motor_rotate_step()
{
	HAL_GPIO_WritePin(GPIO_IN1_PORT, GPIO_IN1_PIN,
			  bitRead(steps_lookup[step_index()], 0)); //28BYJ48 In1
	HAL_GPIO_WritePin(GPIO_IN2_PORT, GPIO_IN2_PIN,
			  bitRead(steps_lookup[step_index()], 1)); //28BYJ48 In2
	HAL_GPIO_WritePin(GPIO_IN3_PORT, GPIO_IN3_PIN,
			  bitRead(steps_lookup[step_index()], 2)); //28BYJ48 In3
	HAL_GPIO_WritePin(GPIO_IN4_PORT, GPIO_IN4_PIN,
			  bitRead(steps_lookup[step_index()], 3)); //28BYJ48 In4
}

static void *thread_motor(void *arg);

// Initialice the internal thread to manage a stepper motor.
// Returns the internal thread id.
pthread_t stepper_motor_initialize(int prio)
{
	/* GPIO Ports Clock Enable */
	__HAL_RCC_GPIOC_CLK_ENABLE();
	__HAL_RCC_GPIOF_CLK_ENABLE();
	__HAL_RCC_GPIOJ_CLK_ENABLE();

	GPIO_InitTypeDef GPIO_InitStruct;

	//Configure GPIO pins:

	// (In1) Pin D8 is in PJ4, so we need to set it up!
	GPIO_InitStruct.Pin = GPIO_IN1_PIN;
	GPIO_InitStruct.Mode = GPIO_MODE_OUTPUT_PP;
	GPIO_InitStruct.Speed = GPIO_SPEED_LOW;
	HAL_GPIO_Init(GPIO_IN1_PORT, &GPIO_InitStruct);

	// (In2) Pin D7 is in PJ3, so we need to set it up!
	GPIO_InitStruct.Pin = GPIO_IN2_PIN;
	GPIO_InitStruct.Mode = GPIO_MODE_OUTPUT_PP;
	GPIO_InitStruct.Speed = GPIO_SPEED_LOW;
	HAL_GPIO_Init(GPIO_IN2_PORT, &GPIO_InitStruct);

	// (In3) Pin D6 is in PF7, so we need to set it up!
	GPIO_InitStruct.Pin = GPIO_IN3_PIN;
	GPIO_InitStruct.Mode = GPIO_MODE_OUTPUT_PP;
	GPIO_InitStruct.Speed = GPIO_SPEED_LOW;
	HAL_GPIO_Init(GPIO_IN3_PORT, &GPIO_InitStruct);

	// (In4) Pin D5 is in PC8, so we need to set it up!
	GPIO_InitStruct.Pin = GPIO_IN4_PIN;
	GPIO_InitStruct.Mode = GPIO_MODE_OUTPUT_PP;
	GPIO_InitStruct.Speed = GPIO_SPEED_LOW;
	HAL_GPIO_Init(GPIO_IN4_PORT, &GPIO_InitStruct);

	stepper_motor_setspeed(20);

	// Create thread
	pthread_attr_t attr;
	pthread_t th;
	struct sched_param sch_param;
	CHK(pthread_attr_init(&attr));
	//CHK(pthread_attr_setinheritsched(&attr, PTHREAD_EXPLICIT_SCHED)); //FIXME:
	CHK(pthread_attr_setdetachstate(&attr, PTHREAD_CREATE_JOINABLE));
	CHK(pthread_attr_setschedpolicy(&attr, SCHED_FIFO));
	sch_param.sched_priority = prio;
	CHK(pthread_attr_setschedparam(&attr, &sch_param));
	CHK(pthread_attr_setstack(&attr, &stacks[0][0], STACKSIZE));
	CHK(pthread_create(&th, &attr, thread_motor, NULL));

	return th;
}

// Set desired speed.
void stepper_motor_setspeed(double grads_per_second)
{
	if (grads_per_second > MX_GRADS_PER_S) {
		grads_per_second = MX_GRADS_PER_S;
	} else if (grads_per_second < -MX_GRADS_PER_S) {
		grads_per_second = -MX_GRADS_PER_S;
	} else if (fabs(grads_per_second) < 0.1) {
		rotating_speed_grads_per_second = 0.0;
		thread_period.tv_nsec = PERIOD_INACTIVE_NS;
		return;
	}

	rotating_speed_grads_per_second = grads_per_second;
	thread_period.tv_nsec = abs((int)(1000000000 / STEPS_PER_GRAD / grads_per_second));
	//printf("thread_period.tv_nsec:%dns\n", thread_period.tv_nsec);
}

// Move to the desired step at the preset speed.
void stepper_motor_move_to_step(int step_objective)
{
	step_counter_objective = step_objective;
}

// Rotate one step clockwise
void stepper_motor_step_clockwise()
{
	step_counter++;
	motor_rotate_step();
}

// Rotate one step anticlockwise
void stepper_motor_step_anticlockwise()
{
	step_counter--;
	motor_rotate_step();
}

int stepper_motor_get_current_step()
{
	return step_counter;
}

int stepper_motor_get_current_step_objective()
{
	return step_counter_objective;
}

void stepper_motor_status(int *step_current, int *step_objective)
{
	*step_current = step_counter;
	*step_objective = step_counter_objective;
}

/*
 * Motor thread.
 */
static void *thread_motor(void *arg)
{
	while (1) {
		if (step_counter < step_counter_objective) {
			stepper_motor_step_clockwise();
		} else if (step_counter > step_counter_objective) {
			stepper_motor_step_anticlockwise();
		}

		long period_ms = timespec2msec(&thread_period);
		k_msleep(period_ms);
	}
}
```
