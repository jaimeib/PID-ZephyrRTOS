## CMakeLists.txt
```
cmake_minimum_required(VERSION 3.20.0)
find_package(Zephyr REQUIRED HINTS $ENV{ZEPHYR_BASE})
project(Practica VERSION 1.0.0 LANGUAGES C)

FILE(GLOB app_sources src/*.c)
target_include_directories(app PRIVATE ./include)
target_include_directories(app PRIVATE $ENV{ZEPHYR_BASE})
target_sources(app PRIVATE ${app_sources})
```

## prj.conf
```kconfig
CONFIG_ASSERT=y
CONFIG_GPIO=y

# Enable pthreads
CONFIG_PTHREAD_IPC=y

# Enable Network
CONFIG_NETWORKING=y
CONFIG_NET_SOCKETS=y
CONFIG_NET_TCP=y
CONFIG_NET_LOG=y

CONFIG_PRINTK=y
CONFIG_STDOUT_CONSOLE=y

# Enable IPv4 support
CONFIG_NET_IPV4=y

# Enable the MQTT Lib
CONFIG_MQTT_LIB=y

# Network Address configuration
CONFIG_NET_CONFIG_SETTINGS=y
CONFIG_NET_CONFIG_MY_IPV4_ADDR="192.0.2.1"
CONFIG_NET_CONFIG_PEER_IPV4_ADDR="192.0.2.2"

# Network debug configuration
CONFIG_NET_LOG=y

# Config stack size
CONFIG_MAIN_STACK_SIZE=1024

CONFIG_NET_SHELL=y

CONFIG_ENTROPY_GENERATOR=y
CONFIG_TEST_RANDOM_GENERATOR=y
CONFIG_MINIMAL_LIBC_MALLOC_ARENA_SIZE=40960
```

## src/main.c
```c
// Zephyr API
#include <zephyr.h>
#include <device.h>
#include <drivers/gpio.h>

//Standard C + POSIX API
#include <stdio.h>
#include <stdlib.h>
#include <string.h>
#include <posix/pthread.h>

//Modules
#include "main.h"
#include "leds.h"
#include "light_sensor.h"
#include "internal_temp.h"
#include "supervisor.h"
#include "mqtt_publisher.h"

//Threads stacks declaration
K_THREAD_STACK_ARRAY_DEFINE(stacks, NUM_THREADS, STACKSIZE);

//Global variables

//Mutex to access the last result stucture
pthread_mutex_t mutex_result;

//Condition variable to signal the supervisor thread
pthread_cond_t cond_result;
bool new_result_for_supervisor;
bool new_result_for_publisher;

//Condition variable to signal main thread when the supervisor thread is ready
pthread_mutex_t mutex_supervisor_ready;
pthread_cond_t cond_supervisor_ready;
bool supervisor_ready;

//Condition variable to signal main thread when the mqtt publisher thread is ready
pthread_mutex_t mutex_publisher_ready;
pthread_cond_t cond_publisher_ready;
bool publisher_ready;

/**
 * 
 */
int main(void)
{
	printf("Starting ... \n");

	//Threads variables:
	pthread_t green_led_thread, light_sensor_thread, internal_temp_thread, supervisor_thread,
		publisher_thread;
	struct sched_param sch_param;
	pthread_attr_t attr;

	//Result variables:
	thread_result_t *last_result = (thread_result_t *)malloc(sizeof(thread_result_t));

	//Mutexes attribute	declaration
	pthread_mutexattr_t mutexattr;

	// Create the mutex attributes object
	pthread_mutexattr_init(&mutexattr);

	// Create the mutex for the result
	if (pthread_mutex_init(&mutex_result, &mutexattr) != 0) {
		printf("Result mutex created\n");
		exit(EXIT_FAILURE);
	}

	// Create the mutex for the sincronization when supervisor thread is ready
	if (pthread_mutex_init(&mutex_supervisor_ready, &mutexattr) != 0) {
		printf("Supervisor mutex created\n");
		exit(EXIT_FAILURE);
	}

	// Create the mutex for the sincronization when publisher thread is ready
	if (pthread_mutex_init(&mutex_publisher_ready, &mutexattr) != 0) {
		printf("Publisher mutex created\n");
		exit(EXIT_FAILURE);
	}

	// Condition variable attributes initialization
	pthread_condattr_t condattr;

	// Create the condition variable attributes object
	pthread_condattr_init(&condattr);

	// Create the condition variable to signal the supervisor & publisher thread
	if (pthread_cond_init(&cond_result, &condattr) != 0) {
		printf("Condition variable to signal the supervisor thread created\n");
		exit(EXIT_FAILURE);
	}

	//Create the condition variable for the sincronization when supervisor thread is ready
	if (pthread_cond_init(&cond_supervisor_ready, &condattr) != 0) {
		printf("Supervisor condition variable created\n");
		exit(EXIT_FAILURE);
	}

	// Create the condition variable for the sincronization when publisher thread is ready
	if (pthread_cond_init(&cond_publisher_ready, &condattr) != 0) {
		printf("Publisher condition variable created\n");
		exit(EXIT_FAILURE);
	}

	//Threads creation:

	// Set the priority of the main program to max_prio-1
	sch_param.sched_priority = (sched_get_priority_max(SCHED_FIFO) - 1);
	if (pthread_setschedparam(pthread_self(), SCHED_FIFO, &sch_param) != 0) {
		printf("Error while setting main thread's priority\n");
		exit(EXIT_FAILURE);
	}

	// Create the thread attributes object
	if (pthread_attr_init(&attr) != 0) {
		printf("Error while initializing attributes\n");
		exit(EXIT_FAILURE);
	}

	// Thread is created dettached
	if (pthread_attr_setdetachstate(&attr, PTHREAD_CREATE_DETACHED) != 0) {
		printf("Error in detachstate attribute\n");
		exit(EXIT_FAILURE);
	}

	// The scheduling policy is fixed-priorities, with
	// FIFO ordering for threads of the same priority
	if (pthread_attr_setschedpolicy(&attr, SCHED_FIFO) != 0) {
		printf("Error in schedpolicy attribute\n");
		exit(EXIT_FAILURE);
	}

	//SUPERVISOR THREAD:

	// Set the priority of supervisor thread to min_prio+10
	sch_param.sched_priority = (sched_get_priority_min(SCHED_FIFO) + 10);
	if (pthread_attr_setschedparam(&attr, &sch_param) != 0) {
		printf("Error in atribute schedparam of Supervisor thread\n");
		exit(EXIT_FAILURE);
	}

	//Set the stack for supervisor thread
	pthread_attr_setstack(&attr, &stacks[0][0], STACKSIZE);

	// Creating thread that supervised the measures
	if (pthread_create(&supervisor_thread, &attr, (void *)supervisor, last_result) != 0) {
		printf("Error: failed to create supervisor thread\n");
		exit(EXIT_FAILURE);
	}

	//PUBLISHER THREAD:

	// Set the priority of MQTT publisher thread to min_prio+9
	sch_param.sched_priority = (sched_get_priority_min(SCHED_FIFO) + 9);
	if (pthread_attr_setschedparam(&attr, &sch_param) != 0) {
		printf("Error in atribute schedparam of MQTT publisher thread\n");
		exit(EXIT_FAILURE);
	}

	//Set the stack for MQTT publisher thread
	pthread_attr_setstack(&attr, &stacks[1][0], STACKSIZE);

	// Creating thread that publish the measures using MQTT
	if (pthread_create(&publisher_thread, &attr, (void *)mqtt_publisher, last_result) != 0) {
		printf("Error: failed to create the MQTT publisher thread\n");
		exit(EXIT_FAILURE);
	}

	//WAIT FOR MQTT SUPERVISOR THREAD TO BE READY BEFORE CREATING THE OTHER THREADS:
	pthread_mutex_lock(&mutex_supervisor_ready);
	while (true) {
		if (!supervisor_ready) {
			pthread_cond_wait(&cond_supervisor_ready, &mutex_supervisor_ready);
		} else {
			break;
		}
	}
	pthread_mutex_unlock(&mutex_supervisor_ready);

	//WAIT FOR MQTT PUBLISHER THREAD TO BE READY BEFORE CREATING THE OTHER THREADS:
	pthread_mutex_lock(&mutex_publisher_ready);
	while (true) {
		if (!publisher_ready) {
			pthread_cond_wait(&cond_publisher_ready, &mutex_publisher_ready);
		} else {
			break;
		}
	}
	pthread_mutex_unlock(&mutex_publisher_ready);

	//LED THREAD:

	// Set the priority of LED thread to min_prio+8
	sch_param.sched_priority = (sched_get_priority_min(SCHED_FIFO) + 8);
	if (pthread_attr_setschedparam(&attr, &sch_param) != 0) {
		printf("Error in atribute schedparam of LED thread\n");
		exit(EXIT_FAILURE);
	}

	//Set the stack for LED thread
	pthread_attr_setstack(&attr, &stacks[2][0], STACKSIZE);

	// Creating thread that blinks LED
	if (pthread_create(&green_led_thread, &attr, (void *)blink_led, (void *)RED1) != 0) {
		printf("Error: failed to create LED thread\n");
		exit(EXIT_FAILURE);
	}

	//LIGHT SENSOR THREAD:

	// Set the priority of light sensor thread to min_prio+7
	sch_param.sched_priority = (sched_get_priority_min(SCHED_FIFO) + 7);
	if (pthread_attr_setschedparam(&attr, &sch_param) != 0) {
		printf("Error in atribute schedparam of Light Sensor thread\n");
		exit(EXIT_FAILURE);
	}

	//Set the stack for light sensor thread
	pthread_attr_setstack(&attr, &stacks[3][0], STACKSIZE);

	// Creating thread that measures light intensity
	if (pthread_create(&light_sensor_thread, &attr, (void *)light_sensor, last_result) != 0) {
		printf("Error: failed to create light sensor thread\n");
		exit(EXIT_FAILURE);
	}

	//INTERNAL TEMPERATURE THREAD:

	// Set the priority of internal temperature sensor thread min_prio+6
	sch_param.sched_priority = (sched_get_priority_min(SCHED_FIFO) + 6);
	if (pthread_attr_setschedparam(&attr, &sch_param) != 0) {
		printf("Error in atribute schedparam of Internal Temperature thread\n");
		exit(EXIT_FAILURE);
	}

	//Set the stack for internal temperature sensor thread
	pthread_attr_setstack(&attr, &stacks[4][0], STACKSIZE);

	// Creating thread that measures light intensity
	if (pthread_create(&internal_temp_thread, &attr, (void *)internal_temp, last_result) != 0) {
		printf("Error: failed to create internal temperature thread\n");
		exit(EXIT_FAILURE);
	}
}
```

## include/internal_temp.h
```c
/* INTERNAL TEMPERATURE SENSOR CONFIGURATION*/

// Internal temperature refresh period
struct timespec internal_temp_period = { .tv_sec = 2, .tv_nsec = 0 };

// Constants for conversion of the internal temperature sensor value
#define MAX_CONVERTED_VALUE 4095 /* Max converted value */
#define AMBIENT_TEMP 25 /* Ambient Temperature */
#define VSENS_AT_AMBIENT_TEMP 760 /* VSENSE value (mv) at ambient temperature */
#define AVG_SLOPE 25 /* Avg_Solpe multiply by 10 */
#define VREF 3300

/* ADC handler declaration */
static ADC_HandleTypeDef AdcHandle;

//ADC FUNCTIONS:
static void ADC_Config(void);
static void Error_Handler(void);
static void SystemClock_Config(void);
static void ADC_Select_CHTemp(void);

//Internal Temperature FUNCTIONS:
void internal_temp(void *ptr_result);
```

## include/leds.h
```c
/* LEDS CONFIGURATION*/

typedef enum { RED1, GREEN1, GREEN2 } led_number_t;

#define BLINK_LED_PERIOD_MS 1000

#define LED0 DT_ALIAS(led0)
#define LED1 DT_ALIAS(led1)
#define LED2 DT_ALIAS(led2)

#if !DT_NODE_HAS_STATUS(LED0, okay)
#error "Unsupported board: led0 devicetree alias is not defined"
#endif

#if !DT_NODE_HAS_STATUS(LED1, okay)
#error "Unsupported board: led1 devicetree alias is not defined"
#endif

#if !DT_NODE_HAS_STATUS(LED2, okay)
#error "Unsupported board: led2 devicetree alias is not defined"
#endif

struct led {
	struct gpio_dt_spec spec;
	const char *gpio_pin_name;
};

static const struct led led0 = {
	.spec = GPIO_DT_SPEC_GET_OR(LED0, gpios, { 0 }),
	.gpio_pin_name = DT_PROP_OR(LED0, label, "RED1"),
};

static const struct led led1 = {
	.spec = GPIO_DT_SPEC_GET_OR(LED1, gpios, { 0 }),
	.gpio_pin_name = DT_PROP_OR(LED1, label, "GREEN1"),
};

static const struct led led2 = {
	.spec = GPIO_DT_SPEC_GET_OR(LED2, gpios, { 0 }),
	.gpio_pin_name = DT_PROP_OR(LED2, label, "GREEN2"),
};

//LED FUNCTIONS:
void blink_function(const struct led *led, uint32_t sleep_ms);
void turn_function(const struct led *led, int status);

void blink_led(led_number_t led_to_blink);
void turn_led(led_number_t led_to_turn, int status);
```

## include/light_sensor.h
```c
/* LIGHT SENSOR CONFIGURATION*/

#define LIGHT_REFRESH_PERIOD 1000 /* Light Sensor refresh period */
#define MAX_CONVERTED_VALUE 4095 /* Max converted value */
#define MAX_LIGHT_VALUE 100 /* Max light value */

/* ADC handler declaration */
static ADC_HandleTypeDef AdcHandle;

//ADC FUNCTIONS:
static void ADC_Config(void);
static void Error_Handler(void);
static void SystemClock_Config(void);
static void ADC_Select_CH0(void);

//Light Sensor FUNCTIONS:
void light_sensor(void *ptr_result);
```

## include/main.h
```c
/* MAIN CONFIGURATION*/

typedef enum { LIGHT, INTERNAL_TEMPERATURE } sensor_type_t;

typedef struct {
	sensor_type_t type;
	int value;
} thread_result_t;

//THREADS CONFIGURATION:
#define STACKSIZE 2048
#define NUM_THREADS 5
```

## include/mqtt_publisher.h
```c
/* MQTT PUBLISHER CONFIGURATION*/

// Sensors values to publish
#define TEMPERATURE_VALUE "internal_temperature"
#define LIGHT_VALUE "light"

//NETWORK:
#ifndef __CONFIG_H__
#define __CONFIG_H__

#define APP_CONNECT_TIMEOUT_MS 2000
#define APP_SLEEP_MSECS 500

#define APP_CONNECT_TRIES 3

#define APP_MQTT_BUFFER_SIZE 128

#define MQTT_CLIENTID "zephyr_publisher"

#endif

//Connection parameters:
#define MQTT_SERVER_ADDRESS "192.0.2.2"
#define MQTT_SERVER_PORT 1883
#define MQTT_TOPIC "v1/devices/me/telemetry"
// FUNCTIONS:
int mqtt_publisher(void *ptr_result);
```

## include/supervisor.h
```c
/* SUPERVISOR CONFIGURATION*/

// THRESHOLD VALUES
#define LOW_LIGHT_VALUE 10
#define HIGH_TEMP_VALUE 28

//Supervisor FUNCTIONS:
void supervisor(void *ptr_result);
```

## include/timespec_operations.h
```c
// MACROS TO OPERATE WITH TIMESPEC STRUCTS

#define incr_timespec(t1, t2)                                                                      \
	do {                                                                                       \
		(t1)->tv_sec += (t2)->tv_sec;                                                      \
		(t1)->tv_nsec += (t2)->tv_nsec;                                                    \
		if ((t1)->tv_nsec >= 1000000000) {                                                 \
			(t1)->tv_sec++;                                                            \
			(t1)->tv_nsec -= 1000000000;                                               \
		}                                                                                  \
	} while (0)
```

## src/MQTT_publisher.c
```c
// Zephyr API
#include <zephyr.h>
#include <device.h>
#include <drivers/gpio.h>

//Standard C + POSIX API
#include <stdio.h>
#include <posix/pthread.h>

//Modules
#include "main.h"

void publish(void *ptr_result)
{
	printf("Publisher thread started\n");
}
```

## src/MQTT_publisher.h
```c
//Publisher FUNCTIONS:
void publish(void *ptr_result);
```

## src/internal_temp.c
```c
// Zephyr API
#include <zephyr.h>
#include <device.h>
#include <drivers/gpio.h>

//Standard C + POSIX API
#include <stdio.h>
#include <posix/pthread.h>

// Hal API
#include <stm32f7xx_hal.h>
#include <stm32f7xx_hal_adc.h>

//Modules
#include "main.h"
#include "internal_temp.h"

void SystemClock_Config(void)
{
	__HAL_RCC_ADC1_CLK_ENABLE(); // Habilita el reloj ADC1
}

void ADC_Select_CHTemp(void)
{
	ADC_ChannelConfTypeDef sConfig = { 0 };

	/* Configure ADC Temperature Sensor Channel */
	sConfig.Channel = ADC_CHANNEL_TEMPSENSOR;
	sConfig.Rank = 1;
	sConfig.SamplingTime = ADC_SAMPLETIME_56CYCLES;
	sConfig.Offset = 0;

	if (HAL_ADC_ConfigChannel(&AdcHandle, &sConfig) != HAL_OK) {
		/* Channel Configuration Error */
		Error_Handler();
	}
}

/**
  * @brief  Configure the ADC.
  * @param  None
  * @retval None
  */
static void ADC_Config(void)
{
	/* Configure the ADC peripheral */
	AdcHandle.Instance = ADC1;

	AdcHandle.Init.ClockPrescaler = ADC_CLOCKPRESCALER_PCLK_DIV4;
	AdcHandle.Init.Resolution = ADC_RESOLUTION_12B;
	AdcHandle.Init.ScanConvMode =
		ENABLE; /* Sequencer disabled (ADC conversion on only 1 channel: channel set on rank 1) */
	AdcHandle.Init.ContinuousConvMode =
		ENABLE; /* Continuous mode enabled to have continuous conversion */
	AdcHandle.Init.DiscontinuousConvMode =
		DISABLE; /* Parameter discarded because sequencer is disabled */
	AdcHandle.Init.NbrOfDiscConversion = 0;
	AdcHandle.Init.ExternalTrigConvEdge =
		ADC_EXTERNALTRIGCONVEDGE_NONE; /* Conversion start not trigged by an external event */
	AdcHandle.Init.ExternalTrigConv = ADC_SOFTWARE_START;
	AdcHandle.Init.DataAlign = ADC_DATAALIGN_RIGHT;
	AdcHandle.Init.NbrOfConversion = 1;
	AdcHandle.Init.DMAContinuousRequests = DISABLE;
	AdcHandle.Init.EOCSelection = DISABLE;

	if (HAL_ADC_Init(&AdcHandle) != HAL_OK) {
		/* ADC initialization Error */
		Error_Handler();
	}
}

/**
  * @brief  This function is executed in case of error occurrence.
  * @param  None
  * @retval None
  */
static void Error_Handler(void)
{
	while (1) {
		printf("Error...");
		HAL_Delay(20);
	}
}

void internal_temp(void *ptr_result)
{
	extern pthread_mutex_t mutex_result;
	extern pthread_cond_t cond_result;
	extern bool new_result_for_supervisor;
	extern bool new_result_for_publisher;

	printf("Internal temperture thread started\n");

	/* Variable used to get converted value */
	__IO int32_t ConvertedValue = 0;
	int32_t JTemp = 0x0;

	SystemClock_Config();

	/* Configure the ADC peripheral */
	ADC_Config();

	// Infinite loop
	while (true) {
		/* Insert a delay define on TEMP_REFRESH_PERIOD */
		HAL_Delay(TEMP_REFRESH_PERIOD);

		// Select ADC_CHTemp
		ADC_Select_CHTemp();
		HAL_ADC_Start(&AdcHandle);
		HAL_ADC_PollForConversion(&AdcHandle, 1000);
		ConvertedValue = HAL_ADC_GetValue(&AdcHandle);
		HAL_ADC_Stop(&AdcHandle);

		// Compute the Junction Temperature value in degreeC
		JTemp = ((((ConvertedValue * VREF) / MAX_CONVERTED_VALUE) - VSENS_AT_AMBIENT_TEMP) *
			 10 / AVG_SLOPE) +
			AMBIENT_TEMP;

		// Print the value
		printf("Internal Temperature is %d degrees \n", JTemp);

		// Send the temperature to the supervisor thread
		pthread_mutex_lock(&mutex_result);
		((thread_result_t *)ptr_result)->type = INTERNAL_TEMPERATURE;
		((thread_result_t *)ptr_result)->value = JTemp;

		// Notify the supervisor & publisher threads
		new_result_for_supervisor = true;
		new_result_for_publisher = true;
		pthread_cond_broadcast(&cond_result);
		pthread_mutex_unlock(&mutex_result);
	}
}
```

## src/internal_temp.h
```c
#define TEMP_REFRESH_PERIOD 500 /* Internal temperature refresh period */
#define MAX_CONVERTED_VALUE 4095 /* Max converted value */
#define AMBIENT_TEMP 25 /* Ambient Temperature */
#define VSENS_AT_AMBIENT_TEMP 760 /* VSENSE value (mv) at ambient temperature */
#define AVG_SLOPE 25 /* Avg_Solpe multiply by 10 */
#define VREF 3300

/* ADC handler declaration */
static ADC_HandleTypeDef AdcHandle;

//ADC FUNCTIONS:
static void ADC_Config(void);
static void Error_Handler(void);
static void SystemClock_Config(void);
static void ADC_Select_CHTemp(void);

//Internal Temperature FUNCTIONS:
void internal_temp(void *ptr_result);
```

## src/leds.c
```c
// Zephyr API
#include <zephyr.h>
#include <device.h>
#include <drivers/gpio.h>

// Standard C API + POSIX API
#include <stdio.h>
#include <posix/time.h>
#include <posix/unistd.h>
#include <posix/pthread.h>

// Modules
#include "leds.h"
#include "timespec_operations.h"

static struct led led0 = {
	.spec = GPIO_DT_SPEC_GET_OR(LED0, gpios, { 0 }),
	.gpio_pin_name = DT_PROP_OR(LED0, label, "RED1"),
	.state = 0,
};

static struct led led1 = {
	.spec = GPIO_DT_SPEC_GET_OR(LED1, gpios, { 0 }),
	.gpio_pin_name = DT_PROP_OR(LED1, label, "GREEN1"),
	.state = 0,
};

static struct led led2 = {
	.spec = GPIO_DT_SPEC_GET_OR(LED2, gpios, { 0 }),
	.gpio_pin_name = DT_PROP_OR(LED2, label, "GREEN2"),
	.state = 0,
};

struct led *select_led(led_number_t led_name)
{
	//Pointer to the Led structure:
	struct led *led = NULL;

	//Select the led to blink
	switch (led_name) {
	case RED1:
		//Select the red (LD1) led:
		led = &led0;
		break;
	case GREEN1:
		//Select the green (LD2) led:
		led = &led1;
		break;
	case GREEN2:
		//Select the green (LD3) led:
		led = &led2;
		break;
	default:
		printf("Error: led_to_blink is not valid\n");
		exit(EXIT_FAILURE);
	}

	return led;
}

void blink_function(struct led *led, struct timespec period)
{
	const struct gpio_dt_spec *spec = &led->spec;
	int status = 0;
	int rc;

	if (!device_is_ready(spec->port)) {
		//Print error message and return
		printf("Error: %s device is not ready\n", spec->port->name);
		return;
	}

	rc = gpio_pin_configure_dt(spec, GPIO_OUTPUT);
	if (rc != 0) {
		//Print error message and return
		printf("Error %d: failed to configure pin %d (LED '%s')\n", rc, spec->pin,
		       led->gpio_pin_name);
		return;
	}

	//Read initial time:
	struct timespec initial_ts;
	clock_gettime(CLOCK_MONOTONIC, &initial_ts);

	// Infinite loop
	while (true) {
		//Switch led:
		gpio_pin_set(spec->port, spec->pin, status % 2);
		led->state = status % 2;

		//Print on console:
		printf("Toggled led %s; Status=%s\n", led->gpio_pin_name,
		       led->state ? "ON" : "OFF");

		//Update status of the led:
		status++;

		//Wait for period (next activation):
		incr_timespec(&initial_ts, &period);
		//FIXME: #6 No POSIX support on Zephyr for clock_nanosleep
		if ((rc = clock_nanosleep(CLOCK_MONOTONIC, TIMER_ABSTIME, &initial_ts, NULL)) !=
		    0) {
			printf("Error in clock_nanosleep: %d\n", rc);
			pthread_exit(NULL);
		}
	}
}

void turn_function(struct led *led, int status)
{
	if (led->state == status) {
		//Led state is already in the desired state
		printf("Led %s is already in state %s\n", led->gpio_pin_name,
		       status ? "ON" : "OFF");
		return;
	}

	const struct gpio_dt_spec *spec = &led->spec;
	int rc;

	if (!device_is_ready(spec->port)) {
		//Print error message and return
		printf("Error: %s device is not ready\n", spec->port->name);
		return;
	}

	rc = gpio_pin_configure_dt(spec, GPIO_OUTPUT);
	if (rc != 0) {
		//Print error message and return
		printf("Error %d: failed to configure pin %d (LED '%s')\n", rc, spec->pin,
		       led->gpio_pin_name);
		return;
	}

	//Switch led:
	gpio_pin_set(spec->port, spec->pin, status);
	led->state = status;

	//Print on console:
	printf("Turned led %s; Status=%s\n", led->gpio_pin_name, led->state % 2 ? "ON" : "OFF");
}

void blink_led(led_number_t led_to_blink)
{
	printf("Blinking led thread started\n");

	//Select the led to blink
	struct led *led_selected = select_led(led_to_blink);

	//Blink the led
	blink_function(led_selected, blinking_led_period);
}

void turn_led(led_number_t led_to_turn, int status)
{
	if (status != 0 && status != 1) {
		//Print error message and return
		printf("Error: status is not valid\n");
		return;
	}

	//Select the led to turn
	struct led *led_selected = select_led(led_to_turn);

	//Turn the led
	turn_function(led_selected, status);
}
```
