## CMakeLists.txt
```
cmake_minimum_required(VERSION 3.20.0)
find_package(Zephyr REQUIRED HINTS $ENV{ZEPHYR_BASE})
project(Practica-Monitorizacion VERSION 1.0.0 LANGUAGES C)

FILE(GLOB app_sources src/*.c)
target_include_directories(app PRIVATE ./include)
target_include_directories(app PRIVATE $ENV{ZEPHYR_BASE})
target_sources(app PRIVATE ${app_sources})
```

## prj.conf
```kconfig
# Enable GPIO
CONFIG_GPIO=y

# Enable pthreads
CONFIG_PTHREAD_IPC=y

#Enable FPU
CONFIG_FPU=y
CONFIG_FPU_SHARING=y

# Enable Network
CONFIG_NETWORKING=y
CONFIG_NET_SOCKETS=y
CONFIG_NET_TCP=y

# Enable IPv4 support
CONFIG_NET_IPV4=y

# Enable the MQTT Lib
CONFIG_MQTT_LIB=y

# Network Address configuration
CONFIG_NET_CONFIG_SETTINGS=y
CONFIG_NET_CONFIG_MY_IPV4_ADDR="192.0.2.1"
CONFIG_NET_CONFIG_PEER_IPV4_ADDR="192.0.2.2"

# Config stack size
CONFIG_MAIN_STACK_SIZE=1024

# Random generator
CONFIG_TEST_RANDOM_GENERATOR=y
```

## src/main.c
```c
// Zephyr API
#include <zephyr.h>
#include <device.h>
#include <drivers/gpio.h>

//Standard C + POSIX API
#include <stdio.h>
#include <stdlib.h>
#include <string.h>
#include <posix/pthread.h>

//Modules
#include "main.h"
#include "leds.h"
#include "light_sensor.h"
#include "internal_temp.h"
#include "supervisor.h"
#include "mqtt_publisher.h"

//Threads stacks declaration
K_THREAD_STACK_ARRAY_DEFINE(stacks, NUM_THREADS, STACKSIZE);

//Global variables

//Mutex to access the last result stucture
pthread_mutex_t mutex_result;

//Condition variable to signal the supervisor thread
pthread_cond_t cond_result;
bool new_result_for_supervisor;
bool new_result_for_publisher;

//Condition variable to signal main thread when the supervisor thread is ready
pthread_mutex_t mutex_supervisor_ready;
pthread_cond_t cond_supervisor_ready;
bool supervisor_ready;

//Condition variable to signal main thread when the mqtt publisher thread is ready
pthread_mutex_t mutex_publisher_ready;
pthread_cond_t cond_publisher_ready;
bool publisher_ready;

/**
 * 
 */
int main(void)
{
	printf("Starting ... \n");

	//Threads variables:
	pthread_t green_led_thread, light_sensor_thread, internal_temp_thread, supervisor_thread,
		publisher_thread;
	struct sched_param sch_param;
	pthread_attr_t attr;

	//Result variables:
	thread_result_t *last_result = (thread_result_t *)malloc(sizeof(thread_result_t));

	//Mutexes attribute	declaration
	pthread_mutexattr_t mutexattr;

	// Create the mutex attributes object
	pthread_mutexattr_init(&mutexattr);

	// Create the mutex for the result
	if (pthread_mutex_init(&mutex_result, &mutexattr) != 0) {
		printf("Result mutex created\n");
		exit(EXIT_FAILURE);
	}

	// Create the mutex for the sincronization when supervisor thread is ready
	if (pthread_mutex_init(&mutex_supervisor_ready, &mutexattr) != 0) {
		printf("Supervisor mutex created\n");
		exit(EXIT_FAILURE);
	}

	// Create the mutex for the sincronization when publisher thread is ready
	if (pthread_mutex_init(&mutex_publisher_ready, &mutexattr) != 0) {
		printf("Publisher mutex created\n");
		exit(EXIT_FAILURE);
	}

	// Condition variable attributes initialization
	pthread_condattr_t condattr;

	// Create the condition variable attributes object
	pthread_condattr_init(&condattr);

	// Create the condition variable to signal the supervisor & publisher thread
	if (pthread_cond_init(&cond_result, &condattr) != 0) {
		printf("Condition variable to signal the supervisor thread created\n");
		exit(EXIT_FAILURE);
	}

	//Create the condition variable for the sincronization when supervisor thread is ready
	if (pthread_cond_init(&cond_supervisor_ready, &condattr) != 0) {
		printf("Supervisor condition variable created\n");
		exit(EXIT_FAILURE);
	}

	// Create the condition variable for the sincronization when publisher thread is ready
	if (pthread_cond_init(&cond_publisher_ready, &condattr) != 0) {
		printf("Publisher condition variable created\n");
		exit(EXIT_FAILURE);
	}

	//Threads creation:

	// Set the priority of the main program to max_prio-1
	sch_param.sched_priority = (sched_get_priority_max(SCHED_FIFO) - 1);
	if (pthread_setschedparam(pthread_self(), SCHED_FIFO, &sch_param) != 0) {
		printf("Error while setting main thread's priority\n");
		exit(EXIT_FAILURE);
	}

	// Create the thread attributes object
	if (pthread_attr_init(&attr) != 0) {
		printf("Error while initializing attributes\n");
		exit(EXIT_FAILURE);
	}

	// Thread is created dettached
	if (pthread_attr_setdetachstate(&attr, PTHREAD_CREATE_DETACHED) != 0) {
		printf("Error in detachstate attribute\n");
		exit(EXIT_FAILURE);
	}

	// The scheduling policy is fixed-priorities, with
	// FIFO ordering for threads of the same priority
	if (pthread_attr_setschedpolicy(&attr, SCHED_FIFO) != 0) {
		printf("Error in schedpolicy attribute\n");
		exit(EXIT_FAILURE);
	}

	//SUPERVISOR THREAD:

	// Set the priority of supervisor thread to min_prio+10
	sch_param.sched_priority = (sched_get_priority_min(SCHED_FIFO) + 10);
	if (pthread_attr_setschedparam(&attr, &sch_param) != 0) {
		printf("Error in atribute schedparam of Supervisor thread\n");
		exit(EXIT_FAILURE);
	}

	//Set the stack for supervisor thread
	pthread_attr_setstack(&attr, &stacks[0][0], STACKSIZE);

	// Creating thread that supervised the measures
	if (pthread_create(&supervisor_thread, &attr, (void *)supervisor, last_result) != 0) {
		printf("Error: failed to create supervisor thread\n");
		exit(EXIT_FAILURE);
	}

	//PUBLISHER THREAD:

	// Set the priority of MQTT publisher thread to min_prio+9
	sch_param.sched_priority = (sched_get_priority_min(SCHED_FIFO) + 9);
	if (pthread_attr_setschedparam(&attr, &sch_param) != 0) {
		printf("Error in atribute schedparam of MQTT publisher thread\n");
		exit(EXIT_FAILURE);
	}

	//Set the stack for MQTT publisher thread
	pthread_attr_setstack(&attr, &stacks[1][0], STACKSIZE);

	// Creating thread that publish the measures using MQTT
	if (pthread_create(&publisher_thread, &attr, (void *)mqtt_publisher, last_result) != 0) {
		printf("Error: failed to create the MQTT publisher thread\n");
		exit(EXIT_FAILURE);
	}

	//WAIT FOR MQTT SUPERVISOR THREAD TO BE READY BEFORE CREATING THE OTHER THREADS:
	pthread_mutex_lock(&mutex_supervisor_ready);
	while (true) {
		if (!supervisor_ready) {
			pthread_cond_wait(&cond_supervisor_ready, &mutex_supervisor_ready);
		} else {
			break;
		}
	}
	pthread_mutex_unlock(&mutex_supervisor_ready);

	//WAIT FOR MQTT PUBLISHER THREAD TO BE READY BEFORE CREATING THE OTHER THREADS:
	pthread_mutex_lock(&mutex_publisher_ready);
	while (true) {
		if (!publisher_ready) {
			pthread_cond_wait(&cond_publisher_ready, &mutex_publisher_ready);
		} else {
			break;
		}
	}
	pthread_mutex_unlock(&mutex_publisher_ready);

	//LED THREAD:

	// Set the priority of LED thread to min_prio+8
	sch_param.sched_priority = (sched_get_priority_min(SCHED_FIFO) + 8);
	if (pthread_attr_setschedparam(&attr, &sch_param) != 0) {
		printf("Error in atribute schedparam of LED thread\n");
		exit(EXIT_FAILURE);
	}

	//Set the stack for LED thread
	pthread_attr_setstack(&attr, &stacks[2][0], STACKSIZE);

	// Creating thread that blinks LED
	if (pthread_create(&green_led_thread, &attr, (void *)blink_led, (void *)RED1) != 0) {
		printf("Error: failed to create LED thread\n");
		exit(EXIT_FAILURE);
	}

	//LIGHT SENSOR THREAD:

	// Set the priority of light sensor thread to min_prio+7
	sch_param.sched_priority = (sched_get_priority_min(SCHED_FIFO) + 7);
	if (pthread_attr_setschedparam(&attr, &sch_param) != 0) {
		printf("Error in atribute schedparam of Light Sensor thread\n");
		exit(EXIT_FAILURE);
	}

	//Set the stack for light sensor thread
	pthread_attr_setstack(&attr, &stacks[3][0], STACKSIZE);

	// Creating thread that measures light intensity
	if (pthread_create(&light_sensor_thread, &attr, (void *)light_sensor, last_result) != 0) {
		printf("Error: failed to create light sensor thread\n");
		exit(EXIT_FAILURE);
	}

	//INTERNAL TEMPERATURE THREAD:

	// Set the priority of internal temperature sensor thread min_prio+6
	sch_param.sched_priority = (sched_get_priority_min(SCHED_FIFO) + 6);
	if (pthread_attr_setschedparam(&attr, &sch_param) != 0) {
		printf("Error in atribute schedparam of Internal Temperature thread\n");
		exit(EXIT_FAILURE);
	}

	//Set the stack for internal temperature sensor thread
	pthread_attr_setstack(&attr, &stacks[4][0], STACKSIZE);

	// Creating thread that measures light intensity
	if (pthread_create(&internal_temp_thread, &attr, (void *)internal_temp, last_result) != 0) {
		printf("Error: failed to create internal temperature thread\n");
		exit(EXIT_FAILURE);
	}

	return 0;
}
```

## include/HAL_ADC.h
```c
/* ADC handler declaration */
static ADC_HandleTypeDef AdcHandle;

//ADC FUNCTIONS:
static void ADC_Config(void);
static void Error_Handler(void);
static void SystemClock_Config(void);
static void ADC_Select_CH0(void);
```

## include/internal_temp.h
```c
/* INTERNAL TEMPERATURE SENSOR CONFIGURATION*/

// Internal temperature refresh period
#define INTERNAL_TEMP_SENSOR_PERIOD_MS 2000

// Constants for conversion of the internal temperature sensor value
#define MAX_CONVERTED_VALUE 4095 /* Max converted value */
#define AMBIENT_TEMP 25 /* Ambient Temperature */
#define VSENS_AT_AMBIENT_TEMP 760 /* VSENSE value (mv) at ambient temperature */
#define AVG_SLOPE 25 /* Avg_Solpe multiply by 10 */
#define VREF 3300

//Internal Temperature FUNCTIONS:
void internal_temp(void *ptr_result);
```

## include/leds.h
```c
/* LEDS CONFIGURATION*/

typedef enum { RED1, GREEN1, GREEN2 } led_number_t;

//Blinking led period
struct timespec blinking_led_period = { .tv_sec = 1, .tv_nsec = 0 };

#define LED0 DT_ALIAS(led0)
#define LED1 DT_ALIAS(led1)
#define LED2 DT_ALIAS(led2)

#if !DT_NODE_HAS_STATUS(LED0, okay)
#error "Unsupported board: led0 devicetree alias is not defined"
#endif

#if !DT_NODE_HAS_STATUS(LED1, okay)
#error "Unsupported board: led1 devicetree alias is not defined"
#endif

#if !DT_NODE_HAS_STATUS(LED2, okay)
#error "Unsupported board: led2 devicetree alias is not defined"
#endif

struct led {
	struct gpio_dt_spec spec;
	const char *gpio_pin_name;
	int state;
};

//LED FUNCTIONS:
void blink_function(struct led *led, struct timespec period);
void turn_function(struct led *led, int status);

void blink_led(led_number_t led_to_blink);
void turn_led(led_number_t led_to_turn, int status);

struct led *select_led(led_number_t led_name);
```

## include/light_sensor.h
```c
/* LIGHT SENSOR CONFIGURATION*/

// Light sensor measurement period
struct timespec light_sensor_period = { .tv_sec = 1, .tv_nsec = 500000000 };

// Constants for conversion of the light sensor value
#define MAX_CONVERTED_VALUE 4095 /* Max converted value */
#define MAX_LIGHT_VALUE 100 /* Max light value */

/* ADC handler declaration */
static ADC_HandleTypeDef AdcHandle;

//ADC FUNCTIONS:
static void ADC_Config(void);
static void Error_Handler(void);
static void SystemClock_Config(void);
static void ADC_Select_CH0(void);

//Light Sensor FUNCTIONS:
void light_sensor(void *ptr_result);
```

## include/main.h
```c
/* MAIN CONFIGURATION*/

typedef enum { LIGHT, INTERNAL_TEMPERATURE } sensor_type_t;

typedef struct {
	sensor_type_t type;
	double value;
} thread_result_t;

//THREADS CONFIGURATION:
#define STACKSIZE 2048
#define NUM_THREADS 5
```

## include/mqtt_publisher.h
```c
/* MQTT PUBLISHER CONFIGURATION*/

//NETWORK:
#ifndef __CONFIG_H__
#define __CONFIG_H__

#define APP_CONNECT_TIMEOUT_MS 2000
#define APP_SLEEP_MSECS 500
#define APP_CONNECT_TRIES 3
#define APP_MQTT_BUFFER_SIZE 128
#define MQTT_CLIENTID "zephyr_publisher"

#endif

//Connection parameters:
#define MQTT_SERVER_ADDRESS "192.0.2.2"
#define MQTT_SERVER_PORT 1883
#define MQTT_TOPIC "v1/devices/me/telemetry"

// FUNCTIONS:
int mqtt_publisher(void *ptr_result);
```

## include/supervisor.h
```c
/* SUPERVISOR CONFIGURATION*/

// THRESHOLD VALUES
#define LOW_LIGHT_VALUE 20
#define HIGH_TEMP_VALUE 25

//Supervisor FUNCTIONS:
void supervisor(void *ptr_result);
```

## src/HAL_ADC.c
```c
//Standard C + POSIX API
#include <stdio.h>

// Hal API
#include <stm32f7xx_hal.h>
#include <stm32f7xx_hal_adc.h>
#include "HAL_ADC.h"

void SystemClock_Config(void)
{
	__HAL_RCC_ADC1_CLK_ENABLE(); // Habilita el reloj ADC1
}

void ADC_Select_CH0(void)
{
	ADC_ChannelConfTypeDef sConfig = { 0 };
	/* Configure for the selected ADC regular channel its corresponding rank in the sequencer and its sample time.
  */
	sConfig.Channel = ADC_CHANNEL_6;
	sConfig.Rank = 1;
	sConfig.SamplingTime = ADC_SAMPLETIME_56CYCLES;
	sConfig.Offset = 0;
	if (HAL_ADC_ConfigChannel(&AdcHandle, &sConfig) != HAL_OK) {
		Error_Handler();
	}
}

/**
  * @brief  Configure the ADC.
  * @param  None
  * @retval None
  */
void ADC_Config(void)
{
	/* Configure the ADC peripheral */
	AdcHandle.Instance = ADC1;

	AdcHandle.Init.ClockPrescaler = ADC_CLOCKPRESCALER_PCLK_DIV4;
	AdcHandle.Init.Resolution = ADC_RESOLUTION_12B;
	AdcHandle.Init.ScanConvMode =
		ENABLE; /* Sequencer disabled (ADC conversion on only 1 channel: channel set on rank 1) */
	AdcHandle.Init.ContinuousConvMode =
		ENABLE; /* Continuous mode enabled to have continuous conversion */
	AdcHandle.Init.DiscontinuousConvMode =
		DISABLE; /* Parameter discarded because sequencer is disabled */
	AdcHandle.Init.NbrOfDiscConversion = 0;
	AdcHandle.Init.ExternalTrigConvEdge =
		ADC_EXTERNALTRIGCONVEDGE_NONE; /* Conversion start not trigged by an external event */
	AdcHandle.Init.ExternalTrigConv = ADC_SOFTWARE_START;
	AdcHandle.Init.DataAlign = ADC_DATAALIGN_RIGHT;
	AdcHandle.Init.NbrOfConversion = 1;
	AdcHandle.Init.DMAContinuousRequests = DISABLE;
	AdcHandle.Init.EOCSelection = DISABLE;

	if (HAL_ADC_Init(&AdcHandle) != HAL_OK) {
		/* ADC initialization Error */
		Error_Handler();
	}
}

/**
  * @brief  This function is executed in case of error occurrence.
  * @param  None
  * @retval None
  */
void Error_Handler(void)
{
	while (1) {
		//Print error message
		printf("Error...");

		// Sleep 20 ms
		HAL_Delay(20);
	}
}
```

## src/internal_temp.c
```c
// Standard C + POSIX API
#include <stdio.h>
#include <posix/time.h>
#include <posix/unistd.h>
#include <posix/pthread.h>

// Hal API
#include <stm32f7xx_hal.h>
#include <stm32f7xx_hal_adc.h>

// Modules
#include "main.h"
#include "internal_temp.h"

/* ADC handler declaration */
static ADC_HandleTypeDef AdcHandle;

// ADC FUNCTIONS:
static void ADC_Config(void);
static void Error_Handler(void);
static void SystemClock_Config(void);
static void ADC_Select_CHTemp(void);

static void SystemClock_Config(void)
{
	__HAL_RCC_ADC1_CLK_ENABLE();
}

static void ADC_Select_CHTemp(void)
{
	ADC_ChannelConfTypeDef sConfig = { 0 };

	/* Configure ADC Temperature Sensor Channel */
	sConfig.Channel = ADC_CHANNEL_TEMPSENSOR;
	sConfig.Rank = 1;
	sConfig.SamplingTime = ADC_SAMPLETIME_56CYCLES;
	sConfig.Offset = 0;

	if (HAL_ADC_ConfigChannel(&AdcHandle, &sConfig) != HAL_OK) {
		/* Channel Configuration Error */
		Error_Handler();
	}
}

/**
 * @brief  Configure the ADC.
 * @param  None
 * @retval None
 */
static void ADC_Config(void)
{
	/* Configure the ADC peripheral */
	AdcHandle.Instance = ADC1;

	AdcHandle.Init.ClockPrescaler = ADC_CLOCKPRESCALER_PCLK_DIV4;
	AdcHandle.Init.Resolution = ADC_RESOLUTION_12B;
	AdcHandle.Init.ScanConvMode =
		ENABLE; /* Sequencer disabled (ADC conversion on only 1 channel: channel set on rank 1) */
	AdcHandle.Init.ContinuousConvMode =
		ENABLE; /* Continuous mode enabled to have continuous conversion */
	AdcHandle.Init.DiscontinuousConvMode =
		DISABLE; /* Parameter discarded because sequencer is disabled */
	AdcHandle.Init.NbrOfDiscConversion = 0;
	AdcHandle.Init.ExternalTrigConvEdge =
		ADC_EXTERNALTRIGCONVEDGE_NONE; /* Conversion start not trigged by an external event */
	AdcHandle.Init.ExternalTrigConv = ADC_SOFTWARE_START;
	AdcHandle.Init.DataAlign = ADC_DATAALIGN_RIGHT;
	AdcHandle.Init.NbrOfConversion = 1;
	AdcHandle.Init.DMAContinuousRequests = DISABLE;
	AdcHandle.Init.EOCSelection = DISABLE;

	if (HAL_ADC_Init(&AdcHandle) != HAL_OK) {
		/* ADC initialization Error */
		Error_Handler();
	}
}

/**
 * @brief  This function is executed in case of error occurrence.
 * @param  None
 * @retval None
 */
static void Error_Handler(void)
{
	while (1) {
		printf("Error...");

		// Sleep 20 ms
		HAL_Delay(20);
	}
}

void internal_temp(void *ptr_result)
{
	extern pthread_mutex_t mutex_result;
	extern pthread_cond_t cond_result;
	extern bool new_result_for_supervisor;
	extern bool new_result_for_publisher;

	printf("Internal temperature thread started\n");

	/* Variable used to get converted value */
	__IO int32_t ConvertedValue = 0;
	double Temp = 0.0;

	// Habilitar el reloj ADC1
	SystemClock_Config();

	/* Configure the ADC peripheral */
	ADC_Config();

	// Infinite loop
	while (true) {
		// Select ADC_CHTemp
		ADC_Select_CHTemp();
		HAL_ADC_Start(&AdcHandle);
		HAL_ADC_PollForConversion(&AdcHandle, 1000);
		ConvertedValue = HAL_ADC_GetValue(&AdcHandle);
		HAL_ADC_Stop(&AdcHandle);

		// Compute the Temperature value in degreeC
		Temp = (((((double)ConvertedValue * VREF) / MAX_CONVERTED_VALUE) -
			 VSENS_AT_AMBIENT_TEMP) *
			10 / AVG_SLOPE) +
		       AMBIENT_TEMP;

		// Print the value
		printf("Internal Temperature is %f degrees \n", Temp);

		// Send the temperature to the supervisor thread
		pthread_mutex_lock(&mutex_result);
		((thread_result_t *)ptr_result)->type = INTERNAL_TEMPERATURE;
		((thread_result_t *)ptr_result)->value = Temp;

		// Notify the supervisor & publisher threads
		new_result_for_supervisor = true;
		new_result_for_publisher = true;
		pthread_cond_broadcast(&cond_result);
		pthread_mutex_unlock(&mutex_result);

		// Wait for period (next activation):
		k_msleep(INTERNAL_TEMP_SENSOR_PERIOD_MS);
	}
}
```

## src/light_sensor.c
```c
// Standard C + POSIX API
#include <stdio.h>
#include <posix/time.h>
#include <posix/unistd.h>
#include <posix/pthread.h>

// Hal API
#include <stm32f7xx_hal.h>
#include <stm32f7xx_hal_adc.h>

//Modules
#include "main.h"
#include "light_sensor.h"

/* ADC handler declaration */
static ADC_HandleTypeDef AdcHandle;

//ADC FUNCTIONS:
static void ADC_Config(void);
static void Error_Handler(void);
static void SystemClock_Config(void);
static void ADC_Select_CH0(void);

static void SystemClock_Config(void)
{
	__HAL_RCC_ADC1_CLK_ENABLE(); // Habilita el reloj ADC1
}

static void ADC_Select_CH0(void)
{
	ADC_ChannelConfTypeDef sConfig = { 0 };
	/* Configure for the selected ADC regular channel its corresponding rank in the sequencer and its sample time.
  */
	sConfig.Channel = ADC_CHANNEL_6;
	sConfig.Rank = 1;
	sConfig.SamplingTime = ADC_SAMPLETIME_56CYCLES;
	sConfig.Offset = 0;
	if (HAL_ADC_ConfigChannel(&AdcHandle, &sConfig) != HAL_OK) {
		Error_Handler();
	}
}

/**
  * @brief  Configure the ADC.
  * @param  None
  * @retval None
  */
static void ADC_Config(void)
{
	/* Configure the ADC peripheral */
	AdcHandle.Instance = ADC1;

	AdcHandle.Init.ClockPrescaler = ADC_CLOCKPRESCALER_PCLK_DIV4;
	AdcHandle.Init.Resolution = ADC_RESOLUTION_12B;
	AdcHandle.Init.ScanConvMode =
		ENABLE; /* Sequencer disabled (ADC conversion on only 1 channel: channel set on rank 1) */
	AdcHandle.Init.ContinuousConvMode =
		ENABLE; /* Continuous mode enabled to have continuous conversion */
	AdcHandle.Init.DiscontinuousConvMode =
		DISABLE; /* Parameter discarded because sequencer is disabled */
	AdcHandle.Init.NbrOfDiscConversion = 0;
	AdcHandle.Init.ExternalTrigConvEdge =
		ADC_EXTERNALTRIGCONVEDGE_NONE; /* Conversion start not trigged by an external event */
	AdcHandle.Init.ExternalTrigConv = ADC_SOFTWARE_START;
	AdcHandle.Init.DataAlign = ADC_DATAALIGN_RIGHT;
	AdcHandle.Init.NbrOfConversion = 1;
	AdcHandle.Init.DMAContinuousRequests = DISABLE;
	AdcHandle.Init.EOCSelection = DISABLE;

	if (HAL_ADC_Init(&AdcHandle) != HAL_OK) {
		/* ADC initialization Error */
		Error_Handler();
	}
}

/**
  * @brief  This function is executed in case of error occurrence.
  * @param  None
  * @retval None
  */
static void Error_Handler(void)
{
	while (1) {
		//Print error message
		printf("Error...");

		// Sleep 20 ms
		HAL_Delay(20);
	}
}

void light_sensor(void *ptr_result)
{
	extern pthread_mutex_t mutex_result;
	extern pthread_cond_t cond_result;
	extern bool new_result_for_supervisor;
	extern bool new_result_for_publisher;

	printf("Light sensor thread started\n");

	/* Variable used to get converted value */
	__IO int32_t converted_light = 0;
	double light_normalized = 0;

	SystemClock_Config();

	/* Configure the ADC peripheral*/
	ADC_Config();

	// Hal API
	GPIO_InitTypeDef GPIO_InitStruct;

	// Pin A0 is in PA6, so we need to set it up!
	GPIO_InitStruct.Pin = GPIO_PIN_6;
	GPIO_InitStruct.Mode = GPIO_MODE_ANALOG;
	GPIO_InitStruct.Speed = GPIO_SPEED_HIGH;
	HAL_GPIO_Init(GPIOA, &GPIO_InitStruct);

	// Infinite loop
	while (true) {
		// Select ADC_CH0
		ADC_Select_CH0();
		HAL_ADC_Start(&AdcHandle);
		HAL_ADC_PollForConversion(&AdcHandle, 1000);
		converted_light = HAL_ADC_GetValue(&AdcHandle);
		HAL_ADC_Stop(&AdcHandle);

		// Normalize the light value
		light_normalized = (double)converted_light * MAX_LIGHT_VALUE / MAX_CONVERTED_VALUE;

		// Print the light value
		printf("Light percentage: %f \n", light_normalized);

		// Send the light value to the supervisor thread
		pthread_mutex_lock(&mutex_result);
		((thread_result_t *)ptr_result)->type = LIGHT;
		((thread_result_t *)ptr_result)->value = light_normalized;

		// Notify the supervisor & publisher threads
		new_result_for_supervisor = true;
		new_result_for_publisher = true;
		pthread_cond_broadcast(&cond_result);
		pthread_mutex_unlock(&mutex_result);

		//Wait for period (next activation):
		k_msleep(LIGHT_SENSOR_PERIOD_MS);
	}
}
```

## src/mqtt_publisher.c
```c
// Zephyr API
#include <net/socket.h>
#include <net/mqtt.h>

//Standard C + POSIX API
#include <stdio.h>
#include <stdlib.h>
#include <string.h>
#include <errno.h>
#include <random/rand32.h>
#include <posix/pthread.h>

//Modules
#include "mqtt_publisher.h"
#include "main.h"

#include <logging/log.h>
LOG_MODULE_REGISTER(net_mqtt_publisher_sample, LOG_LEVEL_DBG);

/* Buffers for MQTT client. */
static uint8_t rx_buffer[APP_MQTT_BUFFER_SIZE];
static uint8_t tx_buffer[APP_MQTT_BUFFER_SIZE];

/* The mqtt client struct */
static struct mqtt_client client_ctx;

/* MQTT Broker details. */
static struct sockaddr_storage broker;

static struct zsock_pollfd fds[1];
static int nfds;

static bool connected;

static void prepare_fds(struct mqtt_client *client)
{
	if (client->transport.type == MQTT_TRANSPORT_NON_SECURE) {
		fds[0].fd = client->transport.tcp.sock;
	}

	fds[0].events = ZSOCK_POLLIN;
	nfds = 1;
}

static void clear_fds(void)
{
	nfds = 0;
}

static int wait(int timeout)
{
	int ret = 0;

	if (nfds > 0) {
		ret = zsock_poll(fds, nfds, timeout);
		if (ret < 0) {
			LOG_ERR("poll error: %d", errno);
		}
	}

	return ret;
}

void mqtt_evt_handler(struct mqtt_client *const client, const struct mqtt_evt *evt)
{
	int err;

	switch (evt->type) {
	case MQTT_EVT_CONNACK:
		if (evt->result != 0) {
			LOG_ERR("MQTT connect failed %d", evt->result);
			break;
		}

		connected = true;
		printf("MQTT client connected!");

		break;

	case MQTT_EVT_DISCONNECT:
		printf("MQTT client disconnected %d", evt->result);

		connected = false;
		clear_fds();

		break;

	case MQTT_EVT_PUBACK:
		if (evt->result != 0) {
			LOG_ERR("MQTT PUBACK error %d", evt->result);
			break;
		}

		printf("PUBACK packet id: %u", evt->param.puback.message_id);

		break;

	case MQTT_EVT_PUBREC:
		if (evt->result != 0) {
			LOG_ERR("MQTT PUBREC error %d", evt->result);
			break;
		}

		printf("PUBREC packet id: %u", evt->param.pubrec.message_id);

		const struct mqtt_pubrel_param rel_param = { .message_id =
								     evt->param.pubrec.message_id };

		err = mqtt_publish_qos2_release(client, &rel_param);
		if (err != 0) {
			LOG_ERR("Failed to send MQTT PUBREL: %d", err);
		}

		break;

	case MQTT_EVT_PUBCOMP:
		if (evt->result != 0) {
			LOG_ERR("MQTT PUBCOMP error %d", evt->result);
			break;
		}

		printf("PUBCOMP packet id: %u", evt->param.pubcomp.message_id);

		break;

	case MQTT_EVT_PINGRESP:
		printf("PINGRESP packet");
		break;

	default:
		break;
	}
}

static char *get_mqtt_topic(void)
{
	return MQTT_TOPIC;
}

static char *get_mqtt_payload(thread_result_t *ptr_result, enum mqtt_qos qos)
{
	static char payload[30];
	thread_result_t data;

	data.type = ptr_result->type;
	data.value = ptr_result->value;

	switch (data.type) {
	case LIGHT:
		snprintk(payload, sizeof(payload), "{light:%f}", data.value);
		break;
	case INTERNAL_TEMPERATURE:
		snprintk(payload, sizeof(payload), "{temperature:%f}", data.value);
		break;
	default:
		break;
	}

	printf("MQTT Payload: %s\n", payload);
	return payload;
}

static int publish(struct mqtt_client *client, thread_result_t *ptr_result, enum mqtt_qos qos)
{
	struct mqtt_publish_param param;

	param.message.topic.qos = qos;
	param.message.topic.topic.utf8 = (uint8_t *)get_mqtt_topic();
	param.message.topic.topic.size = strlen(param.message.topic.topic.utf8);
	param.message.payload.data = get_mqtt_payload(ptr_result, qos);
	param.message.payload.len = strlen(param.message.payload.data);
	param.message_id = sys_rand32_get();
	param.dup_flag = 0U;
	param.retain_flag = 0U;

	return mqtt_publish(client, &param);
}

#define RC_STR(rc) ((rc) == 0 ? "OK" : "ERROR")

#define PRINT_RESULT(func, rc) printf("%s: %d <%s>\n", (func), rc, RC_STR(rc))

static void broker_init(void)
{
	struct sockaddr_in *broker4 = (struct sockaddr_in *)&broker;

	broker4->sin_family = AF_INET;
	broker4->sin_port = htons(MQTT_SERVER_PORT);

	zsock_inet_pton(AF_INET, MQTT_SERVER_ADDRESS, &broker4->sin_addr);
}

static void client_init(struct mqtt_client *client)
{
	mqtt_client_init(client);

	broker_init();

	/* MQTT client configuration */
	client->broker = &broker;
	client->evt_cb = mqtt_evt_handler;
	client->client_id.utf8 = (uint8_t *)MQTT_CLIENTID;
	client->client_id.size = strlen(MQTT_CLIENTID);
	client->password = NULL;
	client->user_name = NULL;
	client->protocol_version = MQTT_VERSION_3_1_1;

	/* MQTT buffers configuration */
	client->rx_buf = rx_buffer;
	client->rx_buf_size = sizeof(rx_buffer);
	client->tx_buf = tx_buffer;
	client->tx_buf_size = sizeof(tx_buffer);
	client->transport.type = MQTT_TRANSPORT_NON_SECURE;
}

/* In this routine we block until the connected variable is 1 */
static int try_to_connect(struct mqtt_client *client)
{
	int rc, i = 0;

	while ((i++ < APP_CONNECT_TRIES) && !connected) {
		client_init(client);

		rc = mqtt_connect(client);
		if (rc != 0) {
			PRINT_RESULT("mqtt_connect", rc);
			k_sleep(K_MSEC(APP_SLEEP_MSECS));
			continue;
		}

		prepare_fds(client);

		wait(APP_CONNECT_TIMEOUT_MS);

		mqtt_input(client);

		if (!connected) {
			mqtt_abort(client);
		}
	}

	if (connected) {
		return 0;
	}

	return -EINVAL;
}

/*
static int process_mqtt_and_sleep(struct mqtt_client *client, int timeout)
{
	int64_t remaining = timeout;
	int64_t start_time = k_uptime_get();
	int rc;

	while (remaining > 0 && connected) {
		if (wait(remaining)) {
			rc = mqtt_input(client);
			if (rc != 0) {
				PRINT_RESULT("mqtt_input", rc);
				return rc;
			}
		}

		rc = mqtt_live(client);
		if (rc != 0 && rc != -EAGAIN) {
			PRINT_RESULT("mqtt_live", rc);
			return rc;
		} else if (rc == 0) {
			rc = mqtt_input(client);
			if (rc != 0) {
				PRINT_RESULT("mqtt_input", rc);
				return rc;
			}
		}

		remaining = timeout + start_time - k_uptime_get();
	}

	return 0;
}
*/

#define SUCCESS_OR_EXIT(rc)                                                                        \
	{                                                                                          \
		if (rc != 0) {                                                                     \
			return 1;                                                                  \
		}                                                                                  \
	}
#define SUCCESS_OR_BREAK(rc)                                                                       \
	{                                                                                          \
		if (rc != 0) {                                                                     \
			break;                                                                     \
		}                                                                                  \
	}

int mqtt_publisher(void *ptr_result)
{
	//Sincronization variables for the result:
	extern pthread_mutex_t mutex_result;
	extern pthread_cond_t cond_result;
	extern bool new_result_for_publisher;

	//Sincronization variables for the publisher is ready:
	extern pthread_mutex_t mutex_publisher_ready;
	extern pthread_cond_t cond_publisher_ready;
	extern bool publisher_ready;

	thread_result_t last_result;

	printf("MQTT publisher thread started\n");
	int r = 0;

	//Try to connect to the client:
	printf("attempting to connect: ");
	r = try_to_connect(&client_ctx);
	PRINT_RESULT("try_to_connect", r);
	SUCCESS_OR_EXIT(r);

	//Signal the main thread that we are connected (ready)
	pthread_mutex_lock(&mutex_publisher_ready);
	publisher_ready = true;
	pthread_cond_signal(&cond_publisher_ready);
	pthread_mutex_unlock(&mutex_publisher_ready);
	printf("MQTT publisher thread is ready\n");

	while (connected) {
		// Wait for a new result
		pthread_mutex_lock(&mutex_result);

		// Wait for the signal from the sensor thread
		while (!new_result_for_publisher) {
			pthread_cond_wait(&cond_result, &mutex_result);
		}

		// Copy the result
		last_result.type = ((thread_result_t *)ptr_result)->type;
		last_result.value = ((thread_result_t *)ptr_result)->value;
		new_result_for_publisher = false;

		// Unlock the mutex
		pthread_mutex_unlock(&mutex_result);

		//Publish the message:
		r = publish(&client_ctx, &last_result, MQTT_QOS_0_AT_MOST_ONCE);
		PRINT_RESULT("mqtt_publish", r);
		SUCCESS_OR_BREAK(r);
	}

	r = mqtt_disconnect(&client_ctx);
	PRINT_RESULT("mqtt_disconnect", r);

	return r;
}
```

## src/supervisor.c
```c
// Zephyr API
#include <zephyr.h>
#include <device.h>
#include <drivers/gpio.h>

//Standard C + POSIX API
#include <stdio.h>
#include <posix/pthread.h>

//Modules
#include "main.h"
#include "supervisor.h"
#include "leds.h"

//Supervisor FUNCTIONS:
void supervisor(void *ptr_result)
{
	//Sincronization variables for the result:
	extern pthread_mutex_t mutex_result;
	extern pthread_cond_t cond_result;
	extern bool new_result_for_supervisor;

	//Sincronization variables for the supervisor is ready:
	extern pthread_mutex_t mutex_supervisor_ready;
	extern pthread_cond_t cond_supervisor_ready;
	extern bool supervisor_ready;

	printf("Supervisor thread started\n");

	thread_result_t last_result;

	//Signal the main thread that the supervisor thread is ready
	pthread_mutex_lock(&mutex_supervisor_ready);
	supervisor_ready = true;
	pthread_cond_signal(&cond_supervisor_ready);
	pthread_mutex_unlock(&mutex_supervisor_ready);
	printf("Supervisor thread is ready\n");

	// Infinite loop
	while (true) {
		// Wait for a new result
		pthread_mutex_lock(&mutex_result);
		// Wait for the signal from the sensor thread
		while (!new_result_for_supervisor) {
			pthread_cond_wait(&cond_result, &mutex_result);
		}

		// Copy the result
		last_result.type = ((thread_result_t *)ptr_result)->type;
		last_result.value = ((thread_result_t *)ptr_result)->value;
		new_result_for_supervisor = false;

		// Unlock the mutex
		pthread_mutex_unlock(&mutex_result);

		//Turns on/off leds depending on the results value of each sensor:
		switch (last_result.type) {
		case LIGHT:
			if (last_result.value <= LOW_LIGHT_VALUE) {
				// Turn on the Green LED 1
				turn_led(GREEN1, 1);
			} else {
				// Turn off the Green LED 1
				turn_led(GREEN1, 0);
			}
			break;
		case INTERNAL_TEMPERATURE:
			if (last_result.value >= HIGH_TEMP_VALUE) {
				// Turn on the Green LED 2
				turn_led(GREEN2, 1);
			} else {
				// Turn off the Green LED 2
				turn_led(GREEN2, 0);
			}
			break;
		default:
			printf("SUPERVISOR: Unknown sensor type\n");
			exit(EXIT_FAILURE);
		}
	}
}
```
